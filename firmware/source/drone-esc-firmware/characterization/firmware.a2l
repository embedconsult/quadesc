ASAP2_VERSION 1 71
/begin PROJECT MAINBOARD "Schematic semantic characterization"
/begin MODULE SOM "Contract v7; firmware engineering values; see per-channel assumptions"
/begin MOD_COMMON "Little endian" BYTE_ORDER MSB_LAST ALIGNMENT_BYTE 1 ALIGNMENT_WORD 1 ALIGNMENT_LONG 1 ALIGNMENT_FLOAT32_IEEE 1 /end MOD_COMMON
/begin RECORD_LAYOUT RL_UWORD FNC_VALUES 1 UWORD ROW_DIR DIRECT /end RECORD_LAYOUT
/begin RECORD_LAYOUT RL_ULONG FNC_VALUES 1 ULONG ROW_DIR DIRECT /end RECORD_LAYOUT
/begin RECORD_LAYOUT RL_FLOAT32_IEEE FNC_VALUES 1 FLOAT32_IEEE ROW_DIR DIRECT /end RECORD_LAYOUT
/begin COMPU_METHOD CM_led_period_ms "wire to physical" LINEAR "%16.7" "ms" COEFFS_LINEAR 1 0 /end COMPU_METHOD
/begin CHARACTERISTIC led_period_ms "Existing LED calibration saved by SET_REQUEST mode1" VALUE 0x1000 RL_UWORD 0 CM_led_period_ms 100 10000 STEP_SIZE 1
 /begin ANNOTATION ANNOTATION_LABEL "CALIBRATION_PERSIST"
  /begin ANNOTATION_TEXT "RAM edit; explicit Save atomically stores whole LED and ADC calibration" /end ANNOTATION_TEXT
 /end ANNOTATION
/end CHARACTERISTIC
/begin COMPU_METHOD CM_led_duty_percent "wire to physical" LINEAR "%16.7" "%" COEFFS_LINEAR 0.1 0 /end COMPU_METHOD
/begin CHARACTERISTIC led_duty_percent "Existing LED calibration saved by SET_REQUEST mode1" VALUE 0x1002 RL_UWORD 0 CM_led_duty_percent 0.0 100.0 STEP_SIZE 0.1
 /begin ANNOTATION ANNOTATION_LABEL "CALIBRATION_PERSIST"
  /begin ANNOTATION_TEXT "RAM edit; explicit Save atomically stores whole LED and ADC calibration" /end ANNOTATION_TEXT
 /end ANNOTATION
/end CHARACTERISTIC
/begin COMPU_METHOD CM_schema_version "wire to physical" LINEAR "%16.7" "" COEFFS_LINEAR 1 0 /end COMPU_METHOD
/begin CHARACTERISTIC schema_version "Mainboard contract version" VALUE 0x1008 RL_UWORD 0 CM_schema_version 7 7 STEP_SIZE 1 READ_ONLY /end CHARACTERISTIC
/begin COMPU_METHOD CM_adc_valid_mask "wire to physical" LINEAR "%16.7" "" COEFFS_LINEAR 1 0 /end COMPU_METHOD
/begin CHARACTERISTIC adc_valid_mask "Last completed scan valid bits channel0..29; clear means raw unavailable" VALUE 0x100c RL_ULONG 0 CM_adc_valid_mask 0 1073741823 STEP_SIZE 1 READ_ONLY /end CHARACTERISTIC
/begin COMPU_METHOD CM_adc_scan_sequence "wire to physical" LINEAR "%16.7" "" COEFFS_LINEAR 1 0 /end COMPU_METHOD
/begin CHARACTERISTIC adc_scan_sequence "Increments after publication of complete scan; read before and after for coherent snapshot" VALUE 0x1010 RL_ULONG 0 CM_adc_scan_sequence 0 4294967295 STEP_SIZE 1 READ_ONLY /end CHARACTERISTIC
/begin COMPU_METHOD CM_adc_age_ms "wire to physical" LINEAR "%16.7" "ms" COEFFS_LINEAR 1 0 /end COMPU_METHOD
/begin CHARACTERISTIC adc_age_ms "Age of last completed scan; UINT32_MAX before first scan" VALUE 0x1014 RL_ULONG 0 CM_adc_age_ms 0 4294967295 STEP_SIZE 1 READ_ONLY /end CHARACTERISTIC
/begin COMPU_METHOD CM_adc_error_mask "wire to physical" LINEAR "%16.7" "" COEFFS_LINEAR 1 0 /end COMPU_METHOD
/begin CHARACTERISTIC adc_error_mask "Last completed scan failed bits channel0..29" VALUE 0x1018 RL_ULONG 0 CM_adc_error_mask 0 1073741823 STEP_SIZE 1 READ_ONLY /end CHARACTERISTIC
/begin COMPU_METHOD CM_fault_asserted_mask "wire to physical" LINEAR "%16.7" "" COEFFS_LINEAR 1 0 /end COMPU_METHOD
/begin CHARACTERISTIC fault_asserted_mask "Raw active-low nFAULT inputs driver0..3; board absent is not proof of health" VALUE 0x101c RL_UWORD 0 CM_fault_asserted_mask 0 15 STEP_SIZE 1 READ_ONLY /end CHARACTERISTIC
/begin COMPU_METHOD CM_adc00_PA3_A0_4 "wire to physical" LINEAR "%16.7" "" COEFFS_LINEAR 1 0 /end COMPU_METHOD
/begin CHARACTERISTIC adc00_PA3_A0_4 "Raw ADC Motor 4 phase A current; PA3/A0_4; M4_IA" VALUE 0x1020 RL_UWORD 0 CM_adc00_PA3_A0_4 0 4095 STEP_SIZE 1 READ_ONLY /end CHARACTERISTIC
/begin COMPU_METHOD CM_adc01_PB3_A0_9 "wire to physical" LINEAR "%16.7" "" COEFFS_LINEAR 1 0 /end COMPU_METHOD
/begin CHARACTERISTIC adc01_PB3_A0_9 "Raw ADC Motor 4 phase A voltage estimate; PB3/A0_9; M4_BEMFA" VALUE 0x1024 RL_UWORD 0 CM_adc01_PB3_A0_9 0 4095 STEP_SIZE 1 READ_ONLY /end CHARACTERISTIC
/begin COMPU_METHOD CM_adc02_PA28_A0_11 "wire to physical" LINEAR "%16.7" "" COEFFS_LINEAR 1 0 /end COMPU_METHOD
/begin CHARACTERISTIC adc02_PA28_A0_11 "Raw ADC Spare PA28 ADC input; PA28/A0_11; unconnected-(J9-PadK1)" VALUE 0x1028 RL_UWORD 0 CM_adc02_PA28_A0_11 0 4095 STEP_SIZE 1 READ_ONLY /end CHARACTERISTIC
/begin COMPU_METHOD CM_adc03_PA17_A0_12 "wire to physical" LINEAR "%16.7" "" COEFFS_LINEAR 1 0 /end COMPU_METHOD
/begin CHARACTERISTIC adc03_PA17_A0_12 "Raw ADC Motor 2 phase A voltage estimate; PA17/A0_12; M2_BEMFA" VALUE 0x102c RL_UWORD 0 CM_adc03_PA17_A0_12 0 4095 STEP_SIZE 1 READ_ONLY /end CHARACTERISTIC
/begin COMPU_METHOD CM_adc04_PA16_A0_15 "wire to physical" LINEAR "%16.7" "" COEFFS_LINEAR 1 0 /end COMPU_METHOD
/begin CHARACTERISTIC adc04_PA16_A0_15 "Raw ADC Motor 2 phase A current; PA16/A0_15; M2_IA" VALUE 0x1030 RL_UWORD 0 CM_adc04_PA16_A0_15 0 4095 STEP_SIZE 1 READ_ONLY /end CHARACTERISTIC
/begin COMPU_METHOD CM_adc05_PC14_A0_18 "wire to physical" LINEAR "%16.7" "" COEFFS_LINEAR 1 0 /end COMPU_METHOD
/begin CHARACTERISTIC adc05_PC14_A0_18 "Raw ADC Motor 1 phase A current; PC14/A0_18; M1_IA" VALUE 0x1034 RL_UWORD 0 CM_adc05_PC14_A0_18 0 4095 STEP_SIZE 1 READ_ONLY /end CHARACTERISTIC
/begin COMPU_METHOD CM_adc06_PC15_A0_19 "wire to physical" LINEAR "%16.7" "" COEFFS_LINEAR 1 0 /end COMPU_METHOD
/begin CHARACTERISTIC adc06_PC15_A0_19 "Raw ADC Motor 1 phase A voltage estimate; PC15/A0_19; M1_BEMFA" VALUE 0x1038 RL_UWORD 0 CM_adc06_PC15_A0_19 0 4095 STEP_SIZE 1 READ_ONLY /end CHARACTERISTIC
/begin COMPU_METHOD CM_adc07_PB24_A0_21 "wire to physical" LINEAR "%16.7" "" COEFFS_LINEAR 1 0 /end COMPU_METHOD
/begin CHARACTERISTIC adc07_PB24_A0_21 "Raw ADC Motor 3 phase A current; PB24/A0_21; M3_IA" VALUE 0x103c RL_UWORD 0 CM_adc07_PB24_A0_21 0 4095 STEP_SIZE 1 READ_ONLY /end CHARACTERISTIC
/begin COMPU_METHOD CM_adc08_PB27_A0_27 "wire to physical" LINEAR "%16.7" "" COEFFS_LINEAR 1 0 /end COMPU_METHOD
/begin CHARACTERISTIC adc08_PB27_A0_27 "Raw ADC Motor 3 phase A voltage estimate; PB27/A0_27; M3_BEMFA" VALUE 0x1040 RL_UWORD 0 CM_adc08_PB27_A0_27 0 4095 STEP_SIZE 1 READ_ONLY /end CHARACTERISTIC
/begin COMPU_METHOD CM_adc09_PB4_A1_5 "wire to physical" LINEAR "%16.7" "" COEFFS_LINEAR 1 0 /end COMPU_METHOD
/begin CHARACTERISTIC adc09_PB4_A1_5 "Raw ADC Motor 2 phase B voltage estimate; PB4/A1_5; M2_BEMFB" VALUE 0x1044 RL_UWORD 0 CM_adc09_PB4_A1_5 0 4095 STEP_SIZE 1 READ_ONLY /end CHARACTERISTIC
/begin COMPU_METHOD CM_adc10_PB1_A1_7 "wire to physical" LINEAR "%16.7" "" COEFFS_LINEAR 1 0 /end COMPU_METHOD
/begin CHARACTERISTIC adc10_PB1_A1_7 "Raw ADC Motor 3 phase B voltage estimate; PB1/A1_7; M3_BEMFB" VALUE 0x1048 RL_UWORD 0 CM_adc10_PB1_A1_7 0 4095 STEP_SIZE 1 READ_ONLY /end CHARACTERISTIC
/begin COMPU_METHOD CM_adc11_PA18_A1_12 "wire to physical" LINEAR "%16.7" "" COEFFS_LINEAR 1 0 /end COMPU_METHOD
/begin CHARACTERISTIC adc11_PA18_A1_12 "Raw ADC Motor 2 phase B current; PA18/A1_12; M2_IB" VALUE 0x104c RL_UWORD 0 CM_adc11_PA18_A1_12 0 4095 STEP_SIZE 1 READ_ONLY /end CHARACTERISTIC
/begin COMPU_METHOD CM_adc12_PA5_A1_13 "wire to physical" LINEAR "%16.7" "" COEFFS_LINEAR 1 0 /end COMPU_METHOD
/begin CHARACTERISTIC adc12_PA5_A1_13 "Raw ADC Motor 2 thermistor resistance; PA5/A1_13; M_TEMP2" VALUE 0x1050 RL_UWORD 0 CM_adc12_PA5_A1_13 0 4095 STEP_SIZE 1 READ_ONLY /end CHARACTERISTIC
/begin COMPU_METHOD CM_adc13_PC10_A1_16 "wire to physical" LINEAR "%16.7" "" COEFFS_LINEAR 1 0 /end COMPU_METHOD
/begin CHARACTERISTIC adc13_PC10_A1_16 "Raw ADC Motor 1 thermistor resistance; PC10/A1_16; M_TEMP1" VALUE 0x1054 RL_UWORD 0 CM_adc13_PC10_A1_16 0 4095 STEP_SIZE 1 READ_ONLY /end CHARACTERISTIC
/begin COMPU_METHOD CM_adc14_PA8_A1_18 "wire to physical" LINEAR "%16.7" "" COEFFS_LINEAR 1 0 /end COMPU_METHOD
/begin CHARACTERISTIC adc14_PA8_A1_18 "Raw ADC Motor 4 phase B current; PA8/A1_18; M4_IB" VALUE 0x1058 RL_UWORD 0 CM_adc14_PA8_A1_18 0 4095 STEP_SIZE 1 READ_ONLY /end CHARACTERISTIC
/begin COMPU_METHOD CM_adc15_PA9_A1_19 "wire to physical" LINEAR "%16.7" "" COEFFS_LINEAR 1 0 /end COMPU_METHOD
/begin CHARACTERISTIC adc15_PA9_A1_19 "Raw ADC Motor 4 phase B voltage estimate; PA9/A1_19; M4_BEMFB" VALUE 0x105c RL_UWORD 0 CM_adc15_PA9_A1_19 0 4095 STEP_SIZE 1 READ_ONLY /end CHARACTERISTIC
/begin COMPU_METHOD CM_adc16_PB25_A1_22 "wire to physical" LINEAR "%16.7" "" COEFFS_LINEAR 1 0 /end COMPU_METHOD
/begin CHARACTERISTIC adc16_PB25_A1_22 "Raw ADC Motor 3 thermistor resistance; PB25/A1_22; M_TEMP3" VALUE 0x1060 RL_UWORD 0 CM_adc16_PB25_A1_22 0 4095 STEP_SIZE 1 READ_ONLY /end CHARACTERISTIC
/begin COMPU_METHOD CM_adc17_PC8_A1_23 "wire to physical" LINEAR "%16.7" "" COEFFS_LINEAR 1 0 /end COMPU_METHOD
/begin CHARACTERISTIC adc17_PC8_A1_23 "Raw ADC Motor 4 thermistor resistance; PC8/A1_23; M_TEMP4" VALUE 0x1064 RL_UWORD 0 CM_adc17_PC8_A1_23 0 4095 STEP_SIZE 1 READ_ONLY /end CHARACTERISTIC
/begin COMPU_METHOD CM_adc18_PC11_A1_24 "wire to physical" LINEAR "%16.7" "" COEFFS_LINEAR 1 0 /end COMPU_METHOD
/begin CHARACTERISTIC adc18_PC11_A1_24 "Raw ADC Motor 1 phase B voltage estimate; PC11/A1_24; M1_BEMFB" VALUE 0x1068 RL_UWORD 0 CM_adc18_PC11_A1_24 0 4095 STEP_SIZE 1 READ_ONLY /end CHARACTERISTIC
/begin COMPU_METHOD CM_adc19_PC12_A1_25 "wire to physical" LINEAR "%16.7" "" COEFFS_LINEAR 1 0 /end COMPU_METHOD
/begin CHARACTERISTIC adc19_PC12_A1_25 "Raw ADC Motor 1 phase B current; PC12/A1_25; M1_IB" VALUE 0x106c RL_UWORD 0 CM_adc19_PC12_A1_25 0 4095 STEP_SIZE 1 READ_ONLY /end CHARACTERISTIC
/begin COMPU_METHOD CM_adc20_PB30_A1_30 "wire to physical" LINEAR "%16.7" "" COEFFS_LINEAR 1 0 /end COMPU_METHOD
/begin CHARACTERISTIC adc20_PB30_A1_30 "Raw ADC Motor 3 phase B current; PB30/A1_30; M3_IB" VALUE 0x1070 RL_UWORD 0 CM_adc20_PB30_A1_30 0 4095 STEP_SIZE 1 READ_ONLY /end CHARACTERISTIC
/begin COMPU_METHOD CM_adc21_PC9_A2_2 "wire to physical" LINEAR "%16.7" "" COEFFS_LINEAR 1 0 /end COMPU_METHOD
/begin CHARACTERISTIC adc21_PC9_A2_2 "Raw ADC Motor 1 phase C voltage estimate; PC9/A2_2; M1_BEMFC" VALUE 0x1074 RL_UWORD 0 CM_adc21_PC9_A2_2 0 4095 STEP_SIZE 1 READ_ONLY /end CHARACTERISTIC
/begin COMPU_METHOD CM_adc22_PC7_A2_4 "wire to physical" LINEAR "%16.7" "" COEFFS_LINEAR 1 0 /end COMPU_METHOD
/begin CHARACTERISTIC adc22_PC7_A2_4 "Raw ADC Motor 4 phase C voltage estimate; PC7/A2_4; M4_BEMFC" VALUE 0x1078 RL_UWORD 0 CM_adc22_PC7_A2_4 0 4095 STEP_SIZE 1 READ_ONLY /end CHARACTERISTIC
/begin COMPU_METHOD CM_adc23_PA29_A2_5 "wire to physical" LINEAR "%16.7" "" COEFFS_LINEAR 1 0 /end COMPU_METHOD
/begin CHARACTERISTIC adc23_PA29_A2_5 "Raw ADC Motor 1 phase C current; PA29/A2_5; M1_IC" VALUE 0x107c RL_UWORD 0 CM_adc23_PA29_A2_5 0 4095 STEP_SIZE 1 READ_ONLY /end CHARACTERISTIC
/begin COMPU_METHOD CM_adc24_PB26_A2_7 "wire to physical" LINEAR "%16.7" "" COEFFS_LINEAR 1 0 /end COMPU_METHOD
/begin CHARACTERISTIC adc24_PB26_A2_7 "Raw ADC Motor 3 phase C current; PB26/A2_7; M3_IC" VALUE 0x1080 RL_UWORD 0 CM_adc24_PB26_A2_7 0 4095 STEP_SIZE 1 READ_ONLY /end CHARACTERISTIC
/begin COMPU_METHOD CM_adc25_PB29_A2_10 "wire to physical" LINEAR "%16.7" "" COEFFS_LINEAR 1 0 /end COMPU_METHOD
/begin CHARACTERISTIC adc25_PB29_A2_10 "Raw ADC Motor 3 phase C voltage estimate; PB29/A2_10; M3_BEMFC" VALUE 0x1084 RL_UWORD 0 CM_adc25_PB29_A2_10 0 4095 STEP_SIZE 1 READ_ONLY /end CHARACTERISTIC
/begin COMPU_METHOD CM_adc26_PA7_A2_22 "wire to physical" LINEAR "%16.7" "" COEFFS_LINEAR 1 0 /end COMPU_METHOD
/begin CHARACTERISTIC adc26_PA7_A2_22 "Raw ADC Motor 2 phase C current; PA7/A2_22; M2_IC" VALUE 0x1088 RL_UWORD 0 CM_adc26_PA7_A2_22 0 4095 STEP_SIZE 1 READ_ONLY /end CHARACTERISTIC
/begin COMPU_METHOD CM_adc27_PB5_A2_24 "wire to physical" LINEAR "%16.7" "" COEFFS_LINEAR 1 0 /end COMPU_METHOD
/begin CHARACTERISTIC adc27_PB5_A2_24 "Raw ADC Motor 2 phase C voltage estimate; PB5/A2_24; M2_BEMFC" VALUE 0x108c RL_UWORD 0 CM_adc27_PB5_A2_24 0 4095 STEP_SIZE 1 READ_ONLY /end CHARACTERISTIC
/begin COMPU_METHOD CM_adc28_PA2_A2_25 "wire to physical" LINEAR "%16.7" "" COEFFS_LINEAR 1 0 /end COMPU_METHOD
/begin CHARACTERISTIC adc28_PA2_A2_25 "Raw ADC Motor 4 phase C current; PA2/A2_25; M4_IC" VALUE 0x1090 RL_UWORD 0 CM_adc28_PA2_A2_25 0 4095 STEP_SIZE 1 READ_ONLY /end CHARACTERISTIC
/begin COMPU_METHOD CM_adc29_PB31_A2_29 "wire to physical" LINEAR "%16.7" "" COEFFS_LINEAR 1 0 /end COMPU_METHOD
/begin CHARACTERISTIC adc29_PB31_A2_29 "Raw ADC Battery voltage; PB31/A2_29; VBAT_SNS" VALUE 0x1094 RL_UWORD 0 CM_adc29_PB31_A2_29 0 4095 STEP_SIZE 1 READ_ONLY /end CHARACTERISTIC
/begin COMPU_METHOD CM_pwm_channel "wire to physical" LINEAR "%16.7" "" COEFFS_LINEAR 1 0 /end COMPU_METHOD
/begin CHARACTERISTIC pwm_channel "Staged route index; see pin map; 13=All motor phases, routes0..5 and7..12, excludes FC telemetry6; continuous only" VALUE 0x1098 RL_UWORD 0 CM_pwm_channel 0 13 STEP_SIZE 1 /end CHARACTERISTIC
/begin COMPU_METHOD CM_pwm_frequency_hz "wire to physical" LINEAR "%16.7" "Hz" COEFFS_LINEAR 1 0 /end COMPU_METHOD
/begin CHARACTERISTIC pwm_frequency_hz "Staged continuous frequency; one selected output globally" VALUE 0x109c RL_ULONG 0 CM_pwm_frequency_hz 1 1000000 STEP_SIZE 1 /end CHARACTERISTIC
/begin COMPU_METHOD CM_pwm_duty_percent "wire to physical" LINEAR "%16.7" "%" COEFFS_LINEAR 0.01 0 /end COMPU_METHOD
/begin CHARACTERISTIC pwm_duty_percent "Staged duty; Apply stops all outputs, Start explicitly begins" VALUE 0x10a0 RL_UWORD 0 CM_pwm_duty_percent 0.0 100.0 STEP_SIZE 0.01 /end CHARACTERISTIC
/begin COMPU_METHOD CM_pulse_width_ns "wire to physical" LINEAR "%16.7" "ns" COEFFS_LINEAR 1 0 /end COMPU_METHOD
/begin CHARACTERISTIC pulse_width_ns "Staged finite pulse high time; timer quantized" VALUE 0x10a4 RL_ULONG 0 CM_pulse_width_ns 100 1000000000 STEP_SIZE 1 /end CHARACTERISTIC
/begin COMPU_METHOD CM_pwm_action "wire to physical" LINEAR "%16.7" "" COEFFS_LINEAR 1 0 /end COMPU_METHOD
/begin CHARACTERISTIC pwm_action "Write1 APPLY stopped config;2 START applied config;3 STOP all;4 SINGLE_SHOT staged channel/width. Reads0. Each write is a new command." VALUE 0x10a8 RL_UWORD 0 CM_pwm_action 0 4 STEP_SIZE 1
 /begin ANNOTATION ANNOTATION_LABEL "XCP_UI_COMMAND" /begin ANNOTATION_TEXT "execute-last; no-save; self-clearing" /end ANNOTATION_TEXT /end ANNOTATION
/end CHARACTERISTIC
/begin COMPU_METHOD CM_pwm_command_sequence "wire to physical" LINEAR "%16.7" "" COEFFS_LINEAR 1 0 /end COMPU_METHOD
/begin CHARACTERISTIC pwm_command_sequence "Accepted PWM commands including failures" VALUE 0x10ac RL_ULONG 0 CM_pwm_command_sequence 0 4294967295 STEP_SIZE 1 READ_ONLY /end CHARACTERISTIC
/begin COMPU_METHOD CM_pwm_completed_sequence "wire to physical" LINEAR "%16.7" "" COEFFS_LINEAR 1 0 /end COMPU_METHOD
/begin CHARACTERISTIC pwm_completed_sequence "Final disposition sequence; shot waits hardware completion, cancellation completes cancelled shot" VALUE 0x10b0 RL_ULONG 0 CM_pwm_completed_sequence 0 4294967295 STEP_SIZE 1 READ_ONLY /end CHARACTERISTIC
/begin COMPU_METHOD CM_pwm_status "wire to physical" LINEAR "%16.7" "" COEFFS_LINEAR 1 0 /end COMPU_METHOD
/begin CHARACTERISTIC pwm_status "0 idle;1 applied;2 continuous;3 pulse busy;4 pulse done;5 stopped;6 HAL error;7 busy;8 invalid;9 timeout" VALUE 0x10b4 RL_UWORD 0 CM_pwm_status 0 9 STEP_SIZE 1 READ_ONLY /end CHARACTERISTIC
/begin COMPU_METHOD CM_pwm_active_channel "wire to physical" LINEAR "%16.7" "" COEFFS_LINEAR 1 0 /end COMPU_METHOD
/begin CHARACTERISTIC pwm_active_channel "Applied channel;65535 none; 13=all twelve motor phases; last applied selector (not running state)" VALUE 0x10b8 RL_UWORD 0 CM_pwm_active_channel 0 65535 STEP_SIZE 1 READ_ONLY /end CHARACTERISTIC
/begin COMPU_METHOD CM_pwm_effective_frequency_hz "wire to physical" LINEAR "%16.7" "Hz" COEFFS_LINEAR 1 0 /end COMPU_METHOD
/begin CHARACTERISTIC pwm_effective_frequency_hz "Integer timer frequency; for shot this is counter wrap rate" VALUE 0x10bc RL_ULONG 0 CM_pwm_effective_frequency_hz 0 16000000 STEP_SIZE 1 READ_ONLY /end CHARACTERISTIC
/begin COMPU_METHOD CM_pwm_effective_high_ns "wire to physical" LINEAR "%16.7" "ns" COEFFS_LINEAR 1 0 /end COMPU_METHOD
/begin CHARACTERISTIC pwm_effective_high_ns "Rounded high time from timer counts" VALUE 0x10c0 RL_ULONG 0 CM_pwm_effective_high_ns 0 4294967295 STEP_SIZE 1 READ_ONLY /end CHARACTERISTIC
/begin COMPU_METHOD CM_pwm_period_ticks "wire to physical" LINEAR "%16.7" "" COEFFS_LINEAR 1 0 /end COMPU_METHOD
/begin CHARACTERISTIC pwm_period_ticks "Timer period ticks; frequency exact=32MHz/divider/ticks" VALUE 0x10c4 RL_ULONG 0 CM_pwm_period_ticks 0 65536 STEP_SIZE 1 READ_ONLY /end CHARACTERISTIC
/begin COMPU_METHOD CM_pwm_high_ticks "wire to physical" LINEAR "%16.7" "" COEFFS_LINEAR 1 0 /end COMPU_METHOD
/begin CHARACTERISTIC pwm_high_ticks "Timer high ticks; high time exact=high_ticks*divider/32MHz" VALUE 0x10c8 RL_ULONG 0 CM_pwm_high_ticks 0 65536 STEP_SIZE 1 READ_ONLY /end CHARACTERISTIC
/begin COMPU_METHOD CM_pwm_clock_divider "wire to physical" LINEAR "%16.7" "" COEFFS_LINEAR 1 0 /end COMPU_METHOD
/begin CHARACTERISTIC pwm_clock_divider "Timer clock prescaler" VALUE 0x10cc RL_ULONG 0 CM_pwm_clock_divider 0 32768 STEP_SIZE 1 READ_ONLY /end CHARACTERISTIC
/begin COMPU_METHOD CM_drv_device "wire to physical" LINEAR "%16.7" "" COEFFS_LINEAR 1 0 /end COMPU_METHOD
/begin CHARACTERISTIC drv_device "Staged DRV chip-select index0..3" VALUE 0x10d0 RL_UWORD 0 CM_drv_device 0 3 STEP_SIZE 1 /end CHARACTERISTIC
/begin COMPU_METHOD CM_drv_register "wire to physical" LINEAR "%16.7" "" COEFFS_LINEAR 1 0 /end COMPU_METHOD
/begin CHARACTERISTIC drv_register "Staged register0/1 read-only;2..6 writable" VALUE 0x10d4 RL_UWORD 0 CM_drv_register 0 6 STEP_SIZE 1 /end CHARACTERISTIC
/begin COMPU_METHOD CM_drv_write_value "wire to physical" LINEAR "%16.7" "" COEFFS_LINEAR 1 0 /end COMPU_METHOD
/begin CHARACTERISTIC drv_write_value "Staged 11-bit register data; reserved bit10 of reg2 rejected" VALUE 0x10d8 RL_UWORD 0 CM_drv_write_value 0 2047 STEP_SIZE 1 /end CHARACTERISTIC
/begin COMPU_METHOD CM_drv_enable_mask "wire to physical" LINEAR "%16.7" "" COEFFS_LINEAR 1 0 /end COMPU_METHOD
/begin CHARACTERISTIC drv_enable_mask "Staged bit0 DRV_ENABLE,bit1 INL_ENABLE. Mask1 diagnostic-only: all PWM forced low, INL low, fixed5s timeout; explicit disable before actuation or rearm after timeout. Mask2/3 refuse faults." VALUE 0x10dc RL_UWORD 0 CM_drv_enable_mask 0 3 STEP_SIZE 1 /end CHARACTERISTIC
/begin COMPU_METHOD CM_drv_action "wire to physical" LINEAR "%16.7" "" COEFFS_LINEAR 1 0 /end COMPU_METHOD
/begin CHARACTERISTIC drv_action "Write1 READ;2 WRITE+READBACK;3 APPLY_ENABLE;4 DISABLE_ALL/PWM_STOP. Reads0. Register commands require enable and wake delay." VALUE 0x10e0 RL_UWORD 0 CM_drv_action 0 4 STEP_SIZE 1
 /begin ANNOTATION ANNOTATION_LABEL "XCP_UI_COMMAND" /begin ANNOTATION_TEXT "execute-last; no-save; self-clearing" /end ANNOTATION_TEXT /end ANNOTATION
/end CHARACTERISTIC
/begin COMPU_METHOD CM_drv_command_sequence "wire to physical" LINEAR "%16.7" "" COEFFS_LINEAR 1 0 /end COMPU_METHOD
/begin CHARACTERISTIC drv_command_sequence "Completed synchronous bounded DRV command sequence" VALUE 0x10e4 RL_ULONG 0 CM_drv_command_sequence 0 4294967295 STEP_SIZE 1 READ_ONLY /end CHARACTERISTIC
/begin COMPU_METHOD CM_drv_status "wire to physical" LINEAR "%16.7" "" COEFFS_LINEAR 1 0 /end COMPU_METHOD
/begin CHARACTERISTIC drv_status "0 idle;1 valid-frame read (presence unproven);2 write readback match;3 enabled requested;4 disabled;5 invalid/no-response;6 transport;7 disabled/waking;8 invalid;9 mismatch/busy;6 also fault;9 also diagnostic timeout/escalation refused" VALUE 0x10e8 RL_UWORD 0 CM_drv_status 0 9 STEP_SIZE 1 READ_ONLY /end CHARACTERISTIC
/begin COMPU_METHOD CM_drv_readback "wire to physical" LINEAR "%16.7" "" COEFFS_LINEAR 1 0 /end COMPU_METHOD
/begin CHARACTERISTIC drv_readback "Last accepted11-bit register data; use status/sequence" VALUE 0x10ec RL_UWORD 0 CM_drv_readback 0 2047 STEP_SIZE 1 READ_ONLY /end CHARACTERISTIC
/begin COMPU_METHOD CM_drv_raw_response "wire to physical" LINEAR "%16.7" "" COEFFS_LINEAR 1 0 /end COMPU_METHOD
/begin CHARACTERISTIC drv_raw_response "Last16-bit SPI response;0xffff is invalid/no-response" VALUE 0x10f0 RL_UWORD 0 CM_drv_raw_response 0 65535 STEP_SIZE 1 READ_ONLY /end CHARACTERISTIC
/begin COMPU_METHOD CM_drv_applied_enable_mask "wire to physical" LINEAR "%16.7" "" COEFFS_LINEAR 1 0 /end COMPU_METHOD
/begin CHARACTERISTIC drv_applied_enable_mask "GPIO requested enable states, not electrical evidence" VALUE 0x10f4 RL_UWORD 0 CM_drv_applied_enable_mask 0 3 STEP_SIZE 1 READ_ONLY /end CHARACTERISTIC
/begin COMPU_METHOD CM_LED_ON "wire to physical" LINEAR "%16.7" "" COEFFS_LINEAR 1 0 /end COMPU_METHOD
/begin CHARACTERISTIC LED_ON "Successful last commanded active-low LED GPIO state; not optical measurement" VALUE 0x10f8 RL_UWORD 0 CM_LED_ON 0 1 STEP_SIZE 1 READ_ONLY /end CHARACTERISTIC
/begin COMPU_METHOD CM_adc00_engineering "wire to physical" LINEAR "%16.7" "A" COEFFS_LINEAR 1 0 /end COMPU_METHOD
/begin CHARACTERISTIC adc00_engineering "Motor 4 phase A current; engineering_A = raw * gain + offset; defaults=(VREF/2 - raw*VREF/4096)/(20*0.001); R28=1mΩ; DRV inverting CSA assumed20V/V and VREF/2 bias; nominal3.3V ADC ref; consult adc flags" VALUE 0x1200 RL_FLOAT32_IEEE 0 CM_adc00_engineering -1000000000.0 1000000000.0 STEP_SIZE 1e-06 READ_ONLY /end CHARACTERISTIC
/begin COMPU_METHOD CM_adc00_gain "wire to physical" LINEAR "%16.7" "A/count" COEFFS_LINEAR 1 0 /end COMPU_METHOD
/begin CHARACTERISTIC adc00_gain "Editable RAM gain; engineering_A = raw * gain + offset; defaults=(VREF/2 - raw*VREF/4096)/(20*0.001)" VALUE 0x1204 RL_FLOAT32_IEEE 0 CM_adc00_gain -10000 10000 STEP_SIZE 1e-06
 /begin ANNOTATION ANNOTATION_LABEL "CALIBRATION_PERSIST"
  /begin ANNOTATION_TEXT "RAM edit; explicit Save atomically stores whole LED and ADC calibration" /end ANNOTATION_TEXT
 /end ANNOTATION
/end CHARACTERISTIC
/begin COMPU_METHOD CM_adc00_offset "wire to physical" LINEAR "%16.7" "A" COEFFS_LINEAR 1 0 /end COMPU_METHOD
/begin CHARACTERISTIC adc00_offset "Editable RAM offset; engineering_A = raw * gain + offset; defaults=(VREF/2 - raw*VREF/4096)/(20*0.001)" VALUE 0x1208 RL_FLOAT32_IEEE 0 CM_adc00_offset -1000000.0 1000000.0 STEP_SIZE 1e-06
 /begin ANNOTATION ANNOTATION_LABEL "CALIBRATION_PERSIST"
  /begin ANNOTATION_TEXT "RAM edit; explicit Save atomically stores whole LED and ADC calibration" /end ANNOTATION_TEXT
 /end ANNOTATION
/end CHARACTERISTIC
/begin COMPU_METHOD CM_adc00_flags "wire to physical" LINEAR "%16.7" "" COEFFS_LINEAR 1 0 /end COMPU_METHOD
/begin CHARACTERISTIC adc00_flags "Flags1 valid2 rail4 spare8 CSA unverified16 nominal32 stale64 Celsius unknown128 invalid" VALUE 0x120c RL_UWORD 0 CM_adc00_flags 0 255 STEP_SIZE 1 READ_ONLY /end CHARACTERISTIC
/begin COMPU_METHOD CM_adc01_engineering "wire to physical" LINEAR "%16.7" "V" COEFFS_LINEAR 1 0 /end COMPU_METHOD
/begin CHARACTERISTIC adc01_engineering "Motor 4 phase A voltage estimate; engineering_V = raw*gain+offset; nominal11*Vadc. Exact ground-referenced phase voltage=11*Vadc-10*V_LS.; R24=33k/R25=3.3k; 11x divider; lower resistor returns to LS source, not GND; consult adc flags" VALUE 0x1210 RL_FLOAT32_IEEE 0 CM_adc01_engineering -1000000000.0 1000000000.0 STEP_SIZE 1e-06 READ_ONLY /end CHARACTERISTIC
/begin COMPU_METHOD CM_adc01_gain "wire to physical" LINEAR "%16.7" "V/count" COEFFS_LINEAR 1 0 /end COMPU_METHOD
/begin CHARACTERISTIC adc01_gain "Editable RAM gain; engineering_V = raw*gain+offset; nominal11*Vadc. Exact ground-referenced phase voltage=11*Vadc-10*V_LS." VALUE 0x1214 RL_FLOAT32_IEEE 0 CM_adc01_gain -10000 10000 STEP_SIZE 1e-06
 /begin ANNOTATION ANNOTATION_LABEL "CALIBRATION_PERSIST"
  /begin ANNOTATION_TEXT "RAM edit; explicit Save atomically stores whole LED and ADC calibration" /end ANNOTATION_TEXT
 /end ANNOTATION
/end CHARACTERISTIC
/begin COMPU_METHOD CM_adc01_offset "wire to physical" LINEAR "%16.7" "V" COEFFS_LINEAR 1 0 /end COMPU_METHOD
/begin CHARACTERISTIC adc01_offset "Editable RAM offset; engineering_V = raw*gain+offset; nominal11*Vadc. Exact ground-referenced phase voltage=11*Vadc-10*V_LS." VALUE 0x1218 RL_FLOAT32_IEEE 0 CM_adc01_offset -1000000.0 1000000.0 STEP_SIZE 1e-06
 /begin ANNOTATION ANNOTATION_LABEL "CALIBRATION_PERSIST"
  /begin ANNOTATION_TEXT "RAM edit; explicit Save atomically stores whole LED and ADC calibration" /end ANNOTATION_TEXT
 /end ANNOTATION
/end CHARACTERISTIC
/begin COMPU_METHOD CM_adc01_flags "wire to physical" LINEAR "%16.7" "" COEFFS_LINEAR 1 0 /end COMPU_METHOD
/begin CHARACTERISTIC adc01_flags "Flags1 valid2 rail4 spare8 CSA unverified16 nominal32 stale64 Celsius unknown128 invalid" VALUE 0x121c RL_UWORD 0 CM_adc01_flags 0 255 STEP_SIZE 1 READ_ONLY /end CHARACTERISTIC
/begin COMPU_METHOD CM_adc02_engineering "wire to physical" LINEAR "%16.7" "V" COEFFS_LINEAR 1 0 /end COMPU_METHOD
/begin CHARACTERISTIC adc02_engineering "Spare PA28 ADC input; engineering_V=raw*(3.3/4096)+offset; Mainboard J9 K1 explicitly NC; SOM mikroBUS AN path; raw pad voltage only; consult adc flags" VALUE 0x1220 RL_FLOAT32_IEEE 0 CM_adc02_engineering -1000000000.0 1000000000.0 STEP_SIZE 1e-06 READ_ONLY /end CHARACTERISTIC
/begin COMPU_METHOD CM_adc02_gain "wire to physical" LINEAR "%16.7" "V/count" COEFFS_LINEAR 1 0 /end COMPU_METHOD
/begin CHARACTERISTIC adc02_gain "Editable RAM gain; engineering_V=raw*(3.3/4096)+offset" VALUE 0x1224 RL_FLOAT32_IEEE 0 CM_adc02_gain -10000 10000 STEP_SIZE 1e-06
 /begin ANNOTATION ANNOTATION_LABEL "CALIBRATION_PERSIST"
  /begin ANNOTATION_TEXT "RAM edit; explicit Save atomically stores whole LED and ADC calibration" /end ANNOTATION_TEXT
 /end ANNOTATION
/end CHARACTERISTIC
/begin COMPU_METHOD CM_adc02_offset "wire to physical" LINEAR "%16.7" "V" COEFFS_LINEAR 1 0 /end COMPU_METHOD
/begin CHARACTERISTIC adc02_offset "Editable RAM offset; engineering_V=raw*(3.3/4096)+offset" VALUE 0x1228 RL_FLOAT32_IEEE 0 CM_adc02_offset -1000000.0 1000000.0 STEP_SIZE 1e-06
 /begin ANNOTATION ANNOTATION_LABEL "CALIBRATION_PERSIST"
  /begin ANNOTATION_TEXT "RAM edit; explicit Save atomically stores whole LED and ADC calibration" /end ANNOTATION_TEXT
 /end ANNOTATION
/end CHARACTERISTIC
/begin COMPU_METHOD CM_adc02_flags "wire to physical" LINEAR "%16.7" "" COEFFS_LINEAR 1 0 /end COMPU_METHOD
/begin CHARACTERISTIC adc02_flags "Flags1 valid2 rail4 spare8 CSA unverified16 nominal32 stale64 Celsius unknown128 invalid" VALUE 0x122c RL_UWORD 0 CM_adc02_flags 0 255 STEP_SIZE 1 READ_ONLY /end CHARACTERISTIC
/begin COMPU_METHOD CM_adc03_engineering "wire to physical" LINEAR "%16.7" "V" COEFFS_LINEAR 1 0 /end COMPU_METHOD
/begin CHARACTERISTIC adc03_engineering "Motor 2 phase A voltage estimate; engineering_V = raw*gain+offset; nominal11*Vadc. Exact ground-referenced phase voltage=11*Vadc-10*V_LS.; R54=33k/R55=3.3k; 11x divider; lower resistor returns to LS source, not GND; consult adc flags" VALUE 0x1230 RL_FLOAT32_IEEE 0 CM_adc03_engineering -1000000000.0 1000000000.0 STEP_SIZE 1e-06 READ_ONLY /end CHARACTERISTIC
/begin COMPU_METHOD CM_adc03_gain "wire to physical" LINEAR "%16.7" "V/count" COEFFS_LINEAR 1 0 /end COMPU_METHOD
/begin CHARACTERISTIC adc03_gain "Editable RAM gain; engineering_V = raw*gain+offset; nominal11*Vadc. Exact ground-referenced phase voltage=11*Vadc-10*V_LS." VALUE 0x1234 RL_FLOAT32_IEEE 0 CM_adc03_gain -10000 10000 STEP_SIZE 1e-06
 /begin ANNOTATION ANNOTATION_LABEL "CALIBRATION_PERSIST"
  /begin ANNOTATION_TEXT "RAM edit; explicit Save atomically stores whole LED and ADC calibration" /end ANNOTATION_TEXT
 /end ANNOTATION
/end CHARACTERISTIC
/begin COMPU_METHOD CM_adc03_offset "wire to physical" LINEAR "%16.7" "V" COEFFS_LINEAR 1 0 /end COMPU_METHOD
/begin CHARACTERISTIC adc03_offset "Editable RAM offset; engineering_V = raw*gain+offset; nominal11*Vadc. Exact ground-referenced phase voltage=11*Vadc-10*V_LS." VALUE 0x1238 RL_FLOAT32_IEEE 0 CM_adc03_offset -1000000.0 1000000.0 STEP_SIZE 1e-06
 /begin ANNOTATION ANNOTATION_LABEL "CALIBRATION_PERSIST"
  /begin ANNOTATION_TEXT "RAM edit; explicit Save atomically stores whole LED and ADC calibration" /end ANNOTATION_TEXT
 /end ANNOTATION
/end CHARACTERISTIC
/begin COMPU_METHOD CM_adc03_flags "wire to physical" LINEAR "%16.7" "" COEFFS_LINEAR 1 0 /end COMPU_METHOD
/begin CHARACTERISTIC adc03_flags "Flags1 valid2 rail4 spare8 CSA unverified16 nominal32 stale64 Celsius unknown128 invalid" VALUE 0x123c RL_UWORD 0 CM_adc03_flags 0 255 STEP_SIZE 1 READ_ONLY /end CHARACTERISTIC
/begin COMPU_METHOD CM_adc04_engineering "wire to physical" LINEAR "%16.7" "A" COEFFS_LINEAR 1 0 /end COMPU_METHOD
/begin CHARACTERISTIC adc04_engineering "Motor 2 phase A current; engineering_A = raw * gain + offset; defaults=(VREF/2 - raw*VREF/4096)/(20*0.001); R58=1mΩ; DRV inverting CSA assumed20V/V and VREF/2 bias; nominal3.3V ADC ref; consult adc flags" VALUE 0x1240 RL_FLOAT32_IEEE 0 CM_adc04_engineering -1000000000.0 1000000000.0 STEP_SIZE 1e-06 READ_ONLY /end CHARACTERISTIC
/begin COMPU_METHOD CM_adc04_gain "wire to physical" LINEAR "%16.7" "A/count" COEFFS_LINEAR 1 0 /end COMPU_METHOD
/begin CHARACTERISTIC adc04_gain "Editable RAM gain; engineering_A = raw * gain + offset; defaults=(VREF/2 - raw*VREF/4096)/(20*0.001)" VALUE 0x1244 RL_FLOAT32_IEEE 0 CM_adc04_gain -10000 10000 STEP_SIZE 1e-06
 /begin ANNOTATION ANNOTATION_LABEL "CALIBRATION_PERSIST"
  /begin ANNOTATION_TEXT "RAM edit; explicit Save atomically stores whole LED and ADC calibration" /end ANNOTATION_TEXT
 /end ANNOTATION
/end CHARACTERISTIC
/begin COMPU_METHOD CM_adc04_offset "wire to physical" LINEAR "%16.7" "A" COEFFS_LINEAR 1 0 /end COMPU_METHOD
/begin CHARACTERISTIC adc04_offset "Editable RAM offset; engineering_A = raw * gain + offset; defaults=(VREF/2 - raw*VREF/4096)/(20*0.001)" VALUE 0x1248 RL_FLOAT32_IEEE 0 CM_adc04_offset -1000000.0 1000000.0 STEP_SIZE 1e-06
 /begin ANNOTATION ANNOTATION_LABEL "CALIBRATION_PERSIST"
  /begin ANNOTATION_TEXT "RAM edit; explicit Save atomically stores whole LED and ADC calibration" /end ANNOTATION_TEXT
 /end ANNOTATION
/end CHARACTERISTIC
/begin COMPU_METHOD CM_adc04_flags "wire to physical" LINEAR "%16.7" "" COEFFS_LINEAR 1 0 /end COMPU_METHOD
/begin CHARACTERISTIC adc04_flags "Flags1 valid2 rail4 spare8 CSA unverified16 nominal32 stale64 Celsius unknown128 invalid" VALUE 0x124c RL_UWORD 0 CM_adc04_flags 0 255 STEP_SIZE 1 READ_ONLY /end CHARACTERISTIC
/begin COMPU_METHOD CM_adc05_engineering "wire to physical" LINEAR "%16.7" "A" COEFFS_LINEAR 1 0 /end COMPU_METHOD
/begin CHARACTERISTIC adc05_engineering "Motor 1 phase A current; engineering_A = raw * gain + offset; defaults=(VREF/2 - raw*VREF/4096)/(20*0.001); R73=1mΩ; DRV inverting CSA assumed20V/V and VREF/2 bias; nominal3.3V ADC ref; consult adc flags" VALUE 0x1250 RL_FLOAT32_IEEE 0 CM_adc05_engineering -1000000000.0 1000000000.0 STEP_SIZE 1e-06 READ_ONLY /end CHARACTERISTIC
/begin COMPU_METHOD CM_adc05_gain "wire to physical" LINEAR "%16.7" "A/count" COEFFS_LINEAR 1 0 /end COMPU_METHOD
/begin CHARACTERISTIC adc05_gain "Editable RAM gain; engineering_A = raw * gain + offset; defaults=(VREF/2 - raw*VREF/4096)/(20*0.001)" VALUE 0x1254 RL_FLOAT32_IEEE 0 CM_adc05_gain -10000 10000 STEP_SIZE 1e-06
 /begin ANNOTATION ANNOTATION_LABEL "CALIBRATION_PERSIST"
  /begin ANNOTATION_TEXT "RAM edit; explicit Save atomically stores whole LED and ADC calibration" /end ANNOTATION_TEXT
 /end ANNOTATION
/end CHARACTERISTIC
/begin COMPU_METHOD CM_adc05_offset "wire to physical" LINEAR "%16.7" "A" COEFFS_LINEAR 1 0 /end COMPU_METHOD
/begin CHARACTERISTIC adc05_offset "Editable RAM offset; engineering_A = raw * gain + offset; defaults=(VREF/2 - raw*VREF/4096)/(20*0.001)" VALUE 0x1258 RL_FLOAT32_IEEE 0 CM_adc05_offset -1000000.0 1000000.0 STEP_SIZE 1e-06
 /begin ANNOTATION ANNOTATION_LABEL "CALIBRATION_PERSIST"
  /begin ANNOTATION_TEXT "RAM edit; explicit Save atomically stores whole LED and ADC calibration" /end ANNOTATION_TEXT
 /end ANNOTATION
/end CHARACTERISTIC
/begin COMPU_METHOD CM_adc05_flags "wire to physical" LINEAR "%16.7" "" COEFFS_LINEAR 1 0 /end COMPU_METHOD
/begin CHARACTERISTIC adc05_flags "Flags1 valid2 rail4 spare8 CSA unverified16 nominal32 stale64 Celsius unknown128 invalid" VALUE 0x125c RL_UWORD 0 CM_adc05_flags 0 255 STEP_SIZE 1 READ_ONLY /end CHARACTERISTIC
/begin COMPU_METHOD CM_adc06_engineering "wire to physical" LINEAR "%16.7" "V" COEFFS_LINEAR 1 0 /end COMPU_METHOD
/begin CHARACTERISTIC adc06_engineering "Motor 1 phase A voltage estimate; engineering_V = raw*gain+offset; nominal11*Vadc. Exact ground-referenced phase voltage=11*Vadc-10*V_LS.; R69=33k/R70=3.3k; 11x divider; lower resistor returns to LS source, not GND; consult adc flags" VALUE 0x1260 RL_FLOAT32_IEEE 0 CM_adc06_engineering -1000000000.0 1000000000.0 STEP_SIZE 1e-06 READ_ONLY /end CHARACTERISTIC
/begin COMPU_METHOD CM_adc06_gain "wire to physical" LINEAR "%16.7" "V/count" COEFFS_LINEAR 1 0 /end COMPU_METHOD
/begin CHARACTERISTIC adc06_gain "Editable RAM gain; engineering_V = raw*gain+offset; nominal11*Vadc. Exact ground-referenced phase voltage=11*Vadc-10*V_LS." VALUE 0x1264 RL_FLOAT32_IEEE 0 CM_adc06_gain -10000 10000 STEP_SIZE 1e-06
 /begin ANNOTATION ANNOTATION_LABEL "CALIBRATION_PERSIST"
  /begin ANNOTATION_TEXT "RAM edit; explicit Save atomically stores whole LED and ADC calibration" /end ANNOTATION_TEXT
 /end ANNOTATION
/end CHARACTERISTIC
/begin COMPU_METHOD CM_adc06_offset "wire to physical" LINEAR "%16.7" "V" COEFFS_LINEAR 1 0 /end COMPU_METHOD
/begin CHARACTERISTIC adc06_offset "Editable RAM offset; engineering_V = raw*gain+offset; nominal11*Vadc. Exact ground-referenced phase voltage=11*Vadc-10*V_LS." VALUE 0x1268 RL_FLOAT32_IEEE 0 CM_adc06_offset -1000000.0 1000000.0 STEP_SIZE 1e-06
 /begin ANNOTATION ANNOTATION_LABEL "CALIBRATION_PERSIST"
  /begin ANNOTATION_TEXT "RAM edit; explicit Save atomically stores whole LED and ADC calibration" /end ANNOTATION_TEXT
 /end ANNOTATION
/end CHARACTERISTIC
/begin COMPU_METHOD CM_adc06_flags "wire to physical" LINEAR "%16.7" "" COEFFS_LINEAR 1 0 /end COMPU_METHOD
/begin CHARACTERISTIC adc06_flags "Flags1 valid2 rail4 spare8 CSA unverified16 nominal32 stale64 Celsius unknown128 invalid" VALUE 0x126c RL_UWORD 0 CM_adc06_flags 0 255 STEP_SIZE 1 READ_ONLY /end CHARACTERISTIC
/begin COMPU_METHOD CM_adc07_engineering "wire to physical" LINEAR "%16.7" "A" COEFFS_LINEAR 1 0 /end COMPU_METHOD
/begin CHARACTERISTIC adc07_engineering "Motor 3 phase A current; engineering_A = raw * gain + offset; defaults=(VREF/2 - raw*VREF/4096)/(20*0.001); R43=1mΩ; DRV inverting CSA assumed20V/V and VREF/2 bias; nominal3.3V ADC ref; consult adc flags" VALUE 0x1270 RL_FLOAT32_IEEE 0 CM_adc07_engineering -1000000000.0 1000000000.0 STEP_SIZE 1e-06 READ_ONLY /end CHARACTERISTIC
/begin COMPU_METHOD CM_adc07_gain "wire to physical" LINEAR "%16.7" "A/count" COEFFS_LINEAR 1 0 /end COMPU_METHOD
/begin CHARACTERISTIC adc07_gain "Editable RAM gain; engineering_A = raw * gain + offset; defaults=(VREF/2 - raw*VREF/4096)/(20*0.001)" VALUE 0x1274 RL_FLOAT32_IEEE 0 CM_adc07_gain -10000 10000 STEP_SIZE 1e-06
 /begin ANNOTATION ANNOTATION_LABEL "CALIBRATION_PERSIST"
  /begin ANNOTATION_TEXT "RAM edit; explicit Save atomically stores whole LED and ADC calibration" /end ANNOTATION_TEXT
 /end ANNOTATION
/end CHARACTERISTIC
/begin COMPU_METHOD CM_adc07_offset "wire to physical" LINEAR "%16.7" "A" COEFFS_LINEAR 1 0 /end COMPU_METHOD
/begin CHARACTERISTIC adc07_offset "Editable RAM offset; engineering_A = raw * gain + offset; defaults=(VREF/2 - raw*VREF/4096)/(20*0.001)" VALUE 0x1278 RL_FLOAT32_IEEE 0 CM_adc07_offset -1000000.0 1000000.0 STEP_SIZE 1e-06
 /begin ANNOTATION ANNOTATION_LABEL "CALIBRATION_PERSIST"
  /begin ANNOTATION_TEXT "RAM edit; explicit Save atomically stores whole LED and ADC calibration" /end ANNOTATION_TEXT
 /end ANNOTATION
/end CHARACTERISTIC
/begin COMPU_METHOD CM_adc07_flags "wire to physical" LINEAR "%16.7" "" COEFFS_LINEAR 1 0 /end COMPU_METHOD
/begin CHARACTERISTIC adc07_flags "Flags1 valid2 rail4 spare8 CSA unverified16 nominal32 stale64 Celsius unknown128 invalid" VALUE 0x127c RL_UWORD 0 CM_adc07_flags 0 255 STEP_SIZE 1 READ_ONLY /end CHARACTERISTIC
/begin COMPU_METHOD CM_adc08_engineering "wire to physical" LINEAR "%16.7" "V" COEFFS_LINEAR 1 0 /end COMPU_METHOD
/begin CHARACTERISTIC adc08_engineering "Motor 3 phase A voltage estimate; engineering_V = raw*gain+offset; nominal11*Vadc. Exact ground-referenced phase voltage=11*Vadc-10*V_LS.; R39=33k/R40=3.3k; 11x divider; lower resistor returns to LS source, not GND; consult adc flags" VALUE 0x1280 RL_FLOAT32_IEEE 0 CM_adc08_engineering -1000000000.0 1000000000.0 STEP_SIZE 1e-06 READ_ONLY /end CHARACTERISTIC
/begin COMPU_METHOD CM_adc08_gain "wire to physical" LINEAR "%16.7" "V/count" COEFFS_LINEAR 1 0 /end COMPU_METHOD
/begin CHARACTERISTIC adc08_gain "Editable RAM gain; engineering_V = raw*gain+offset; nominal11*Vadc. Exact ground-referenced phase voltage=11*Vadc-10*V_LS." VALUE 0x1284 RL_FLOAT32_IEEE 0 CM_adc08_gain -10000 10000 STEP_SIZE 1e-06
 /begin ANNOTATION ANNOTATION_LABEL "CALIBRATION_PERSIST"
  /begin ANNOTATION_TEXT "RAM edit; explicit Save atomically stores whole LED and ADC calibration" /end ANNOTATION_TEXT
 /end ANNOTATION
/end CHARACTERISTIC
/begin COMPU_METHOD CM_adc08_offset "wire to physical" LINEAR "%16.7" "V" COEFFS_LINEAR 1 0 /end COMPU_METHOD
/begin CHARACTERISTIC adc08_offset "Editable RAM offset; engineering_V = raw*gain+offset; nominal11*Vadc. Exact ground-referenced phase voltage=11*Vadc-10*V_LS." VALUE 0x1288 RL_FLOAT32_IEEE 0 CM_adc08_offset -1000000.0 1000000.0 STEP_SIZE 1e-06
 /begin ANNOTATION ANNOTATION_LABEL "CALIBRATION_PERSIST"
  /begin ANNOTATION_TEXT "RAM edit; explicit Save atomically stores whole LED and ADC calibration" /end ANNOTATION_TEXT
 /end ANNOTATION
/end CHARACTERISTIC
/begin COMPU_METHOD CM_adc08_flags "wire to physical" LINEAR "%16.7" "" COEFFS_LINEAR 1 0 /end COMPU_METHOD
/begin CHARACTERISTIC adc08_flags "Flags1 valid2 rail4 spare8 CSA unverified16 nominal32 stale64 Celsius unknown128 invalid" VALUE 0x128c RL_UWORD 0 CM_adc08_flags 0 255 STEP_SIZE 1 READ_ONLY /end CHARACTERISTIC
/begin COMPU_METHOD CM_adc09_engineering "wire to physical" LINEAR "%16.7" "V" COEFFS_LINEAR 1 0 /end COMPU_METHOD
/begin CHARACTERISTIC adc09_engineering "Motor 2 phase B voltage estimate; engineering_V = raw*gain+offset; nominal11*Vadc. Exact ground-referenced phase voltage=11*Vadc-10*V_LS.; R59=33k/R60=3.3k; 11x divider; lower resistor returns to LS source, not GND; consult adc flags" VALUE 0x1290 RL_FLOAT32_IEEE 0 CM_adc09_engineering -1000000000.0 1000000000.0 STEP_SIZE 1e-06 READ_ONLY /end CHARACTERISTIC
/begin COMPU_METHOD CM_adc09_gain "wire to physical" LINEAR "%16.7" "V/count" COEFFS_LINEAR 1 0 /end COMPU_METHOD
/begin CHARACTERISTIC adc09_gain "Editable RAM gain; engineering_V = raw*gain+offset; nominal11*Vadc. Exact ground-referenced phase voltage=11*Vadc-10*V_LS." VALUE 0x1294 RL_FLOAT32_IEEE 0 CM_adc09_gain -10000 10000 STEP_SIZE 1e-06
 /begin ANNOTATION ANNOTATION_LABEL "CALIBRATION_PERSIST"
  /begin ANNOTATION_TEXT "RAM edit; explicit Save atomically stores whole LED and ADC calibration" /end ANNOTATION_TEXT
 /end ANNOTATION
/end CHARACTERISTIC
/begin COMPU_METHOD CM_adc09_offset "wire to physical" LINEAR "%16.7" "V" COEFFS_LINEAR 1 0 /end COMPU_METHOD
/begin CHARACTERISTIC adc09_offset "Editable RAM offset; engineering_V = raw*gain+offset; nominal11*Vadc. Exact ground-referenced phase voltage=11*Vadc-10*V_LS." VALUE 0x1298 RL_FLOAT32_IEEE 0 CM_adc09_offset -1000000.0 1000000.0 STEP_SIZE 1e-06
 /begin ANNOTATION ANNOTATION_LABEL "CALIBRATION_PERSIST"
  /begin ANNOTATION_TEXT "RAM edit; explicit Save atomically stores whole LED and ADC calibration" /end ANNOTATION_TEXT
 /end ANNOTATION
/end CHARACTERISTIC
/begin COMPU_METHOD CM_adc09_flags "wire to physical" LINEAR "%16.7" "" COEFFS_LINEAR 1 0 /end COMPU_METHOD
/begin CHARACTERISTIC adc09_flags "Flags1 valid2 rail4 spare8 CSA unverified16 nominal32 stale64 Celsius unknown128 invalid" VALUE 0x129c RL_UWORD 0 CM_adc09_flags 0 255 STEP_SIZE 1 READ_ONLY /end CHARACTERISTIC
/begin COMPU_METHOD CM_adc10_engineering "wire to physical" LINEAR "%16.7" "V" COEFFS_LINEAR 1 0 /end COMPU_METHOD
/begin CHARACTERISTIC adc10_engineering "Motor 3 phase B voltage estimate; engineering_V = raw*gain+offset; nominal11*Vadc. Exact ground-referenced phase voltage=11*Vadc-10*V_LS.; R44=33k/R45=3.3k; 11x divider; lower resistor returns to LS source, not GND; consult adc flags" VALUE 0x12a0 RL_FLOAT32_IEEE 0 CM_adc10_engineering -1000000000.0 1000000000.0 STEP_SIZE 1e-06 READ_ONLY /end CHARACTERISTIC
/begin COMPU_METHOD CM_adc10_gain "wire to physical" LINEAR "%16.7" "V/count" COEFFS_LINEAR 1 0 /end COMPU_METHOD
/begin CHARACTERISTIC adc10_gain "Editable RAM gain; engineering_V = raw*gain+offset; nominal11*Vadc. Exact ground-referenced phase voltage=11*Vadc-10*V_LS." VALUE 0x12a4 RL_FLOAT32_IEEE 0 CM_adc10_gain -10000 10000 STEP_SIZE 1e-06
 /begin ANNOTATION ANNOTATION_LABEL "CALIBRATION_PERSIST"
  /begin ANNOTATION_TEXT "RAM edit; explicit Save atomically stores whole LED and ADC calibration" /end ANNOTATION_TEXT
 /end ANNOTATION
/end CHARACTERISTIC
/begin COMPU_METHOD CM_adc10_offset "wire to physical" LINEAR "%16.7" "V" COEFFS_LINEAR 1 0 /end COMPU_METHOD
/begin CHARACTERISTIC adc10_offset "Editable RAM offset; engineering_V = raw*gain+offset; nominal11*Vadc. Exact ground-referenced phase voltage=11*Vadc-10*V_LS." VALUE 0x12a8 RL_FLOAT32_IEEE 0 CM_adc10_offset -1000000.0 1000000.0 STEP_SIZE 1e-06
 /begin ANNOTATION ANNOTATION_LABEL "CALIBRATION_PERSIST"
  /begin ANNOTATION_TEXT "RAM edit; explicit Save atomically stores whole LED and ADC calibration" /end ANNOTATION_TEXT
 /end ANNOTATION
/end CHARACTERISTIC
/begin COMPU_METHOD CM_adc10_flags "wire to physical" LINEAR "%16.7" "" COEFFS_LINEAR 1 0 /end COMPU_METHOD
/begin CHARACTERISTIC adc10_flags "Flags1 valid2 rail4 spare8 CSA unverified16 nominal32 stale64 Celsius unknown128 invalid" VALUE 0x12ac RL_UWORD 0 CM_adc10_flags 0 255 STEP_SIZE 1 READ_ONLY /end CHARACTERISTIC
/begin COMPU_METHOD CM_adc11_engineering "wire to physical" LINEAR "%16.7" "A" COEFFS_LINEAR 1 0 /end COMPU_METHOD
/begin CHARACTERISTIC adc11_engineering "Motor 2 phase B current; engineering_A = raw * gain + offset; defaults=(VREF/2 - raw*VREF/4096)/(20*0.001); R63=1mΩ; DRV inverting CSA assumed20V/V and VREF/2 bias; nominal3.3V ADC ref; consult adc flags" VALUE 0x12b0 RL_FLOAT32_IEEE 0 CM_adc11_engineering -1000000000.0 1000000000.0 STEP_SIZE 1e-06 READ_ONLY /end CHARACTERISTIC
/begin COMPU_METHOD CM_adc11_gain "wire to physical" LINEAR "%16.7" "A/count" COEFFS_LINEAR 1 0 /end COMPU_METHOD
/begin CHARACTERISTIC adc11_gain "Editable RAM gain; engineering_A = raw * gain + offset; defaults=(VREF/2 - raw*VREF/4096)/(20*0.001)" VALUE 0x12b4 RL_FLOAT32_IEEE 0 CM_adc11_gain -10000 10000 STEP_SIZE 1e-06
 /begin ANNOTATION ANNOTATION_LABEL "CALIBRATION_PERSIST"
  /begin ANNOTATION_TEXT "RAM edit; explicit Save atomically stores whole LED and ADC calibration" /end ANNOTATION_TEXT
 /end ANNOTATION
/end CHARACTERISTIC
/begin COMPU_METHOD CM_adc11_offset "wire to physical" LINEAR "%16.7" "A" COEFFS_LINEAR 1 0 /end COMPU_METHOD
/begin CHARACTERISTIC adc11_offset "Editable RAM offset; engineering_A = raw * gain + offset; defaults=(VREF/2 - raw*VREF/4096)/(20*0.001)" VALUE 0x12b8 RL_FLOAT32_IEEE 0 CM_adc11_offset -1000000.0 1000000.0 STEP_SIZE 1e-06
 /begin ANNOTATION ANNOTATION_LABEL "CALIBRATION_PERSIST"
  /begin ANNOTATION_TEXT "RAM edit; explicit Save atomically stores whole LED and ADC calibration" /end ANNOTATION_TEXT
 /end ANNOTATION
/end CHARACTERISTIC
/begin COMPU_METHOD CM_adc11_flags "wire to physical" LINEAR "%16.7" "" COEFFS_LINEAR 1 0 /end COMPU_METHOD
/begin CHARACTERISTIC adc11_flags "Flags1 valid2 rail4 spare8 CSA unverified16 nominal32 stale64 Celsius unknown128 invalid" VALUE 0x12bc RL_UWORD 0 CM_adc11_flags 0 255 STEP_SIZE 1 READ_ONLY /end CHARACTERISTIC
/begin COMPU_METHOD CM_adc12_engineering "wire to physical" LINEAR "%16.7" "ohm" COEFFS_LINEAR 1 0 /end COMPU_METHOD
/begin CHARACTERISTIC adc12_engineering "Motor 2 thermistor resistance; engineering_ohm = (10000*raw/(4096-raw))*gain + offset; raw0/4095 invalid/saturated; R5=10k to same VAA as ADC reference; nonlinear divider resistance, gain1/offset0 trim; consult adc flags" VALUE 0x12c0 RL_FLOAT32_IEEE 0 CM_adc12_engineering -1000000000.0 1000000000.0 STEP_SIZE 1e-06 READ_ONLY /end CHARACTERISTIC
/begin COMPU_METHOD CM_adc12_gain "wire to physical" LINEAR "%16.7" "trim" COEFFS_LINEAR 1 0 /end COMPU_METHOD
/begin CHARACTERISTIC adc12_gain "Editable RAM gain; engineering_ohm = (10000*raw/(4096-raw))*gain + offset; raw0/4095 invalid/saturated" VALUE 0x12c4 RL_FLOAT32_IEEE 0 CM_adc12_gain -10000 10000 STEP_SIZE 1e-06
 /begin ANNOTATION ANNOTATION_LABEL "CALIBRATION_PERSIST"
  /begin ANNOTATION_TEXT "RAM edit; explicit Save atomically stores whole LED and ADC calibration" /end ANNOTATION_TEXT
 /end ANNOTATION
/end CHARACTERISTIC
/begin COMPU_METHOD CM_adc12_offset "wire to physical" LINEAR "%16.7" "ohm" COEFFS_LINEAR 1 0 /end COMPU_METHOD
/begin CHARACTERISTIC adc12_offset "Editable RAM offset; engineering_ohm = (10000*raw/(4096-raw))*gain + offset; raw0/4095 invalid/saturated" VALUE 0x12c8 RL_FLOAT32_IEEE 0 CM_adc12_offset -1000000.0 1000000.0 STEP_SIZE 1e-06
 /begin ANNOTATION ANNOTATION_LABEL "CALIBRATION_PERSIST"
  /begin ANNOTATION_TEXT "RAM edit; explicit Save atomically stores whole LED and ADC calibration" /end ANNOTATION_TEXT
 /end ANNOTATION
/end CHARACTERISTIC
/begin COMPU_METHOD CM_adc12_flags "wire to physical" LINEAR "%16.7" "" COEFFS_LINEAR 1 0 /end COMPU_METHOD
/begin CHARACTERISTIC adc12_flags "Flags1 valid2 rail4 spare8 CSA unverified16 nominal32 stale64 Celsius unknown128 invalid" VALUE 0x12cc RL_UWORD 0 CM_adc12_flags 0 255 STEP_SIZE 1 READ_ONLY /end CHARACTERISTIC
/begin COMPU_METHOD CM_adc13_engineering "wire to physical" LINEAR "%16.7" "ohm" COEFFS_LINEAR 1 0 /end COMPU_METHOD
/begin CHARACTERISTIC adc13_engineering "Motor 1 thermistor resistance; engineering_ohm = (10000*raw/(4096-raw))*gain + offset; raw0/4095 invalid/saturated; R2=10k to same VAA as ADC reference; nonlinear divider resistance, gain1/offset0 trim; consult adc flags" VALUE 0x12d0 RL_FLOAT32_IEEE 0 CM_adc13_engineering -1000000000.0 1000000000.0 STEP_SIZE 1e-06 READ_ONLY /end CHARACTERISTIC
/begin COMPU_METHOD CM_adc13_gain "wire to physical" LINEAR "%16.7" "trim" COEFFS_LINEAR 1 0 /end COMPU_METHOD
/begin CHARACTERISTIC adc13_gain "Editable RAM gain; engineering_ohm = (10000*raw/(4096-raw))*gain + offset; raw0/4095 invalid/saturated" VALUE 0x12d4 RL_FLOAT32_IEEE 0 CM_adc13_gain -10000 10000 STEP_SIZE 1e-06
 /begin ANNOTATION ANNOTATION_LABEL "CALIBRATION_PERSIST"
  /begin ANNOTATION_TEXT "RAM edit; explicit Save atomically stores whole LED and ADC calibration" /end ANNOTATION_TEXT
 /end ANNOTATION
/end CHARACTERISTIC
/begin COMPU_METHOD CM_adc13_offset "wire to physical" LINEAR "%16.7" "ohm" COEFFS_LINEAR 1 0 /end COMPU_METHOD
/begin CHARACTERISTIC adc13_offset "Editable RAM offset; engineering_ohm = (10000*raw/(4096-raw))*gain + offset; raw0/4095 invalid/saturated" VALUE 0x12d8 RL_FLOAT32_IEEE 0 CM_adc13_offset -1000000.0 1000000.0 STEP_SIZE 1e-06
 /begin ANNOTATION ANNOTATION_LABEL "CALIBRATION_PERSIST"
  /begin ANNOTATION_TEXT "RAM edit; explicit Save atomically stores whole LED and ADC calibration" /end ANNOTATION_TEXT
 /end ANNOTATION
/end CHARACTERISTIC
/begin COMPU_METHOD CM_adc13_flags "wire to physical" LINEAR "%16.7" "" COEFFS_LINEAR 1 0 /end COMPU_METHOD
/begin CHARACTERISTIC adc13_flags "Flags1 valid2 rail4 spare8 CSA unverified16 nominal32 stale64 Celsius unknown128 invalid" VALUE 0x12dc RL_UWORD 0 CM_adc13_flags 0 255 STEP_SIZE 1 READ_ONLY /end CHARACTERISTIC
/begin COMPU_METHOD CM_adc14_engineering "wire to physical" LINEAR "%16.7" "A" COEFFS_LINEAR 1 0 /end COMPU_METHOD
/begin CHARACTERISTIC adc14_engineering "Motor 4 phase B current; engineering_A = raw * gain + offset; defaults=(VREF/2 - raw*VREF/4096)/(20*0.001); R33=1mΩ; DRV inverting CSA assumed20V/V and VREF/2 bias; nominal3.3V ADC ref; consult adc flags" VALUE 0x12e0 RL_FLOAT32_IEEE 0 CM_adc14_engineering -1000000000.0 1000000000.0 STEP_SIZE 1e-06 READ_ONLY /end CHARACTERISTIC
/begin COMPU_METHOD CM_adc14_gain "wire to physical" LINEAR "%16.7" "A/count" COEFFS_LINEAR 1 0 /end COMPU_METHOD
/begin CHARACTERISTIC adc14_gain "Editable RAM gain; engineering_A = raw * gain + offset; defaults=(VREF/2 - raw*VREF/4096)/(20*0.001)" VALUE 0x12e4 RL_FLOAT32_IEEE 0 CM_adc14_gain -10000 10000 STEP_SIZE 1e-06
 /begin ANNOTATION ANNOTATION_LABEL "CALIBRATION_PERSIST"
  /begin ANNOTATION_TEXT "RAM edit; explicit Save atomically stores whole LED and ADC calibration" /end ANNOTATION_TEXT
 /end ANNOTATION
/end CHARACTERISTIC
/begin COMPU_METHOD CM_adc14_offset "wire to physical" LINEAR "%16.7" "A" COEFFS_LINEAR 1 0 /end COMPU_METHOD
/begin CHARACTERISTIC adc14_offset "Editable RAM offset; engineering_A = raw * gain + offset; defaults=(VREF/2 - raw*VREF/4096)/(20*0.001)" VALUE 0x12e8 RL_FLOAT32_IEEE 0 CM_adc14_offset -1000000.0 1000000.0 STEP_SIZE 1e-06
 /begin ANNOTATION ANNOTATION_LABEL "CALIBRATION_PERSIST"
  /begin ANNOTATION_TEXT "RAM edit; explicit Save atomically stores whole LED and ADC calibration" /end ANNOTATION_TEXT
 /end ANNOTATION
/end CHARACTERISTIC
/begin COMPU_METHOD CM_adc14_flags "wire to physical" LINEAR "%16.7" "" COEFFS_LINEAR 1 0 /end COMPU_METHOD
/begin CHARACTERISTIC adc14_flags "Flags1 valid2 rail4 spare8 CSA unverified16 nominal32 stale64 Celsius unknown128 invalid" VALUE 0x12ec RL_UWORD 0 CM_adc14_flags 0 255 STEP_SIZE 1 READ_ONLY /end CHARACTERISTIC
/begin COMPU_METHOD CM_adc15_engineering "wire to physical" LINEAR "%16.7" "V" COEFFS_LINEAR 1 0 /end COMPU_METHOD
/begin CHARACTERISTIC adc15_engineering "Motor 4 phase B voltage estimate; engineering_V = raw*gain+offset; nominal11*Vadc. Exact ground-referenced phase voltage=11*Vadc-10*V_LS.; R29=33k/R30=3.3k; 11x divider; lower resistor returns to LS source, not GND; consult adc flags" VALUE 0x12f0 RL_FLOAT32_IEEE 0 CM_adc15_engineering -1000000000.0 1000000000.0 STEP_SIZE 1e-06 READ_ONLY /end CHARACTERISTIC
/begin COMPU_METHOD CM_adc15_gain "wire to physical" LINEAR "%16.7" "V/count" COEFFS_LINEAR 1 0 /end COMPU_METHOD
/begin CHARACTERISTIC adc15_gain "Editable RAM gain; engineering_V = raw*gain+offset; nominal11*Vadc. Exact ground-referenced phase voltage=11*Vadc-10*V_LS." VALUE 0x12f4 RL_FLOAT32_IEEE 0 CM_adc15_gain -10000 10000 STEP_SIZE 1e-06
 /begin ANNOTATION ANNOTATION_LABEL "CALIBRATION_PERSIST"
  /begin ANNOTATION_TEXT "RAM edit; explicit Save atomically stores whole LED and ADC calibration" /end ANNOTATION_TEXT
 /end ANNOTATION
/end CHARACTERISTIC
/begin COMPU_METHOD CM_adc15_offset "wire to physical" LINEAR "%16.7" "V" COEFFS_LINEAR 1 0 /end COMPU_METHOD
/begin CHARACTERISTIC adc15_offset "Editable RAM offset; engineering_V = raw*gain+offset; nominal11*Vadc. Exact ground-referenced phase voltage=11*Vadc-10*V_LS." VALUE 0x12f8 RL_FLOAT32_IEEE 0 CM_adc15_offset -1000000.0 1000000.0 STEP_SIZE 1e-06
 /begin ANNOTATION ANNOTATION_LABEL "CALIBRATION_PERSIST"
  /begin ANNOTATION_TEXT "RAM edit; explicit Save atomically stores whole LED and ADC calibration" /end ANNOTATION_TEXT
 /end ANNOTATION
/end CHARACTERISTIC
/begin COMPU_METHOD CM_adc15_flags "wire to physical" LINEAR "%16.7" "" COEFFS_LINEAR 1 0 /end COMPU_METHOD
/begin CHARACTERISTIC adc15_flags "Flags1 valid2 rail4 spare8 CSA unverified16 nominal32 stale64 Celsius unknown128 invalid" VALUE 0x12fc RL_UWORD 0 CM_adc15_flags 0 255 STEP_SIZE 1 READ_ONLY /end CHARACTERISTIC
/begin COMPU_METHOD CM_adc16_engineering "wire to physical" LINEAR "%16.7" "ohm" COEFFS_LINEAR 1 0 /end COMPU_METHOD
/begin CHARACTERISTIC adc16_engineering "Motor 3 thermistor resistance; engineering_ohm = (10000*raw/(4096-raw))*gain + offset; raw0/4095 invalid/saturated; R9=10k to same VAA as ADC reference; nonlinear divider resistance, gain1/offset0 trim; consult adc flags" VALUE 0x1300 RL_FLOAT32_IEEE 0 CM_adc16_engineering -1000000000.0 1000000000.0 STEP_SIZE 1e-06 READ_ONLY /end CHARACTERISTIC
/begin COMPU_METHOD CM_adc16_gain "wire to physical" LINEAR "%16.7" "trim" COEFFS_LINEAR 1 0 /end COMPU_METHOD
/begin CHARACTERISTIC adc16_gain "Editable RAM gain; engineering_ohm = (10000*raw/(4096-raw))*gain + offset; raw0/4095 invalid/saturated" VALUE 0x1304 RL_FLOAT32_IEEE 0 CM_adc16_gain -10000 10000 STEP_SIZE 1e-06
 /begin ANNOTATION ANNOTATION_LABEL "CALIBRATION_PERSIST"
  /begin ANNOTATION_TEXT "RAM edit; explicit Save atomically stores whole LED and ADC calibration" /end ANNOTATION_TEXT
 /end ANNOTATION
/end CHARACTERISTIC
/begin COMPU_METHOD CM_adc16_offset "wire to physical" LINEAR "%16.7" "ohm" COEFFS_LINEAR 1 0 /end COMPU_METHOD
/begin CHARACTERISTIC adc16_offset "Editable RAM offset; engineering_ohm = (10000*raw/(4096-raw))*gain + offset; raw0/4095 invalid/saturated" VALUE 0x1308 RL_FLOAT32_IEEE 0 CM_adc16_offset -1000000.0 1000000.0 STEP_SIZE 1e-06
 /begin ANNOTATION ANNOTATION_LABEL "CALIBRATION_PERSIST"
  /begin ANNOTATION_TEXT "RAM edit; explicit Save atomically stores whole LED and ADC calibration" /end ANNOTATION_TEXT
 /end ANNOTATION
/end CHARACTERISTIC
/begin COMPU_METHOD CM_adc16_flags "wire to physical" LINEAR "%16.7" "" COEFFS_LINEAR 1 0 /end COMPU_METHOD
/begin CHARACTERISTIC adc16_flags "Flags1 valid2 rail4 spare8 CSA unverified16 nominal32 stale64 Celsius unknown128 invalid" VALUE 0x130c RL_UWORD 0 CM_adc16_flags 0 255 STEP_SIZE 1 READ_ONLY /end CHARACTERISTIC
/begin COMPU_METHOD CM_adc17_engineering "wire to physical" LINEAR "%16.7" "ohm" COEFFS_LINEAR 1 0 /end COMPU_METHOD
/begin CHARACTERISTIC adc17_engineering "Motor 4 thermistor resistance; engineering_ohm = (10000*raw/(4096-raw))*gain + offset; raw0/4095 invalid/saturated; R11=10k to same VAA as ADC reference; nonlinear divider resistance, gain1/offset0 trim; consult adc flags" VALUE 0x1310 RL_FLOAT32_IEEE 0 CM_adc17_engineering -1000000000.0 1000000000.0 STEP_SIZE 1e-06 READ_ONLY /end CHARACTERISTIC
/begin COMPU_METHOD CM_adc17_gain "wire to physical" LINEAR "%16.7" "trim" COEFFS_LINEAR 1 0 /end COMPU_METHOD
/begin CHARACTERISTIC adc17_gain "Editable RAM gain; engineering_ohm = (10000*raw/(4096-raw))*gain + offset; raw0/4095 invalid/saturated" VALUE 0x1314 RL_FLOAT32_IEEE 0 CM_adc17_gain -10000 10000 STEP_SIZE 1e-06
 /begin ANNOTATION ANNOTATION_LABEL "CALIBRATION_PERSIST"
  /begin ANNOTATION_TEXT "RAM edit; explicit Save atomically stores whole LED and ADC calibration" /end ANNOTATION_TEXT
 /end ANNOTATION
/end CHARACTERISTIC
/begin COMPU_METHOD CM_adc17_offset "wire to physical" LINEAR "%16.7" "ohm" COEFFS_LINEAR 1 0 /end COMPU_METHOD
/begin CHARACTERISTIC adc17_offset "Editable RAM offset; engineering_ohm = (10000*raw/(4096-raw))*gain + offset; raw0/4095 invalid/saturated" VALUE 0x1318 RL_FLOAT32_IEEE 0 CM_adc17_offset -1000000.0 1000000.0 STEP_SIZE 1e-06
 /begin ANNOTATION ANNOTATION_LABEL "CALIBRATION_PERSIST"
  /begin ANNOTATION_TEXT "RAM edit; explicit Save atomically stores whole LED and ADC calibration" /end ANNOTATION_TEXT
 /end ANNOTATION
/end CHARACTERISTIC
/begin COMPU_METHOD CM_adc17_flags "wire to physical" LINEAR "%16.7" "" COEFFS_LINEAR 1 0 /end COMPU_METHOD
/begin CHARACTERISTIC adc17_flags "Flags1 valid2 rail4 spare8 CSA unverified16 nominal32 stale64 Celsius unknown128 invalid" VALUE 0x131c RL_UWORD 0 CM_adc17_flags 0 255 STEP_SIZE 1 READ_ONLY /end CHARACTERISTIC
/begin COMPU_METHOD CM_adc18_engineering "wire to physical" LINEAR "%16.7" "V" COEFFS_LINEAR 1 0 /end COMPU_METHOD
/begin CHARACTERISTIC adc18_engineering "Motor 1 phase B voltage estimate; engineering_V = raw*gain+offset; nominal11*Vadc. Exact ground-referenced phase voltage=11*Vadc-10*V_LS.; R74=33k/R75=3.3k; 11x divider; lower resistor returns to LS source, not GND; consult adc flags" VALUE 0x1320 RL_FLOAT32_IEEE 0 CM_adc18_engineering -1000000000.0 1000000000.0 STEP_SIZE 1e-06 READ_ONLY /end CHARACTERISTIC
/begin COMPU_METHOD CM_adc18_gain "wire to physical" LINEAR "%16.7" "V/count" COEFFS_LINEAR 1 0 /end COMPU_METHOD
/begin CHARACTERISTIC adc18_gain "Editable RAM gain; engineering_V = raw*gain+offset; nominal11*Vadc. Exact ground-referenced phase voltage=11*Vadc-10*V_LS." VALUE 0x1324 RL_FLOAT32_IEEE 0 CM_adc18_gain -10000 10000 STEP_SIZE 1e-06
 /begin ANNOTATION ANNOTATION_LABEL "CALIBRATION_PERSIST"
  /begin ANNOTATION_TEXT "RAM edit; explicit Save atomically stores whole LED and ADC calibration" /end ANNOTATION_TEXT
 /end ANNOTATION
/end CHARACTERISTIC
/begin COMPU_METHOD CM_adc18_offset "wire to physical" LINEAR "%16.7" "V" COEFFS_LINEAR 1 0 /end COMPU_METHOD
/begin CHARACTERISTIC adc18_offset "Editable RAM offset; engineering_V = raw*gain+offset; nominal11*Vadc. Exact ground-referenced phase voltage=11*Vadc-10*V_LS." VALUE 0x1328 RL_FLOAT32_IEEE 0 CM_adc18_offset -1000000.0 1000000.0 STEP_SIZE 1e-06
 /begin ANNOTATION ANNOTATION_LABEL "CALIBRATION_PERSIST"
  /begin ANNOTATION_TEXT "RAM edit; explicit Save atomically stores whole LED and ADC calibration" /end ANNOTATION_TEXT
 /end ANNOTATION
/end CHARACTERISTIC
/begin COMPU_METHOD CM_adc18_flags "wire to physical" LINEAR "%16.7" "" COEFFS_LINEAR 1 0 /end COMPU_METHOD
/begin CHARACTERISTIC adc18_flags "Flags1 valid2 rail4 spare8 CSA unverified16 nominal32 stale64 Celsius unknown128 invalid" VALUE 0x132c RL_UWORD 0 CM_adc18_flags 0 255 STEP_SIZE 1 READ_ONLY /end CHARACTERISTIC
/begin COMPU_METHOD CM_adc19_engineering "wire to physical" LINEAR "%16.7" "A" COEFFS_LINEAR 1 0 /end COMPU_METHOD
/begin CHARACTERISTIC adc19_engineering "Motor 1 phase B current; engineering_A = raw * gain + offset; defaults=(VREF/2 - raw*VREF/4096)/(20*0.001); R78=1mΩ; DRV inverting CSA assumed20V/V and VREF/2 bias; nominal3.3V ADC ref; consult adc flags" VALUE 0x1330 RL_FLOAT32_IEEE 0 CM_adc19_engineering -1000000000.0 1000000000.0 STEP_SIZE 1e-06 READ_ONLY /end CHARACTERISTIC
/begin COMPU_METHOD CM_adc19_gain "wire to physical" LINEAR "%16.7" "A/count" COEFFS_LINEAR 1 0 /end COMPU_METHOD
/begin CHARACTERISTIC adc19_gain "Editable RAM gain; engineering_A = raw * gain + offset; defaults=(VREF/2 - raw*VREF/4096)/(20*0.001)" VALUE 0x1334 RL_FLOAT32_IEEE 0 CM_adc19_gain -10000 10000 STEP_SIZE 1e-06
 /begin ANNOTATION ANNOTATION_LABEL "CALIBRATION_PERSIST"
  /begin ANNOTATION_TEXT "RAM edit; explicit Save atomically stores whole LED and ADC calibration" /end ANNOTATION_TEXT
 /end ANNOTATION
/end CHARACTERISTIC
/begin COMPU_METHOD CM_adc19_offset "wire to physical" LINEAR "%16.7" "A" COEFFS_LINEAR 1 0 /end COMPU_METHOD
/begin CHARACTERISTIC adc19_offset "Editable RAM offset; engineering_A = raw * gain + offset; defaults=(VREF/2 - raw*VREF/4096)/(20*0.001)" VALUE 0x1338 RL_FLOAT32_IEEE 0 CM_adc19_offset -1000000.0 1000000.0 STEP_SIZE 1e-06
 /begin ANNOTATION ANNOTATION_LABEL "CALIBRATION_PERSIST"
  /begin ANNOTATION_TEXT "RAM edit; explicit Save atomically stores whole LED and ADC calibration" /end ANNOTATION_TEXT
 /end ANNOTATION
/end CHARACTERISTIC
/begin COMPU_METHOD CM_adc19_flags "wire to physical" LINEAR "%16.7" "" COEFFS_LINEAR 1 0 /end COMPU_METHOD
/begin CHARACTERISTIC adc19_flags "Flags1 valid2 rail4 spare8 CSA unverified16 nominal32 stale64 Celsius unknown128 invalid" VALUE 0x133c RL_UWORD 0 CM_adc19_flags 0 255 STEP_SIZE 1 READ_ONLY /end CHARACTERISTIC
/begin COMPU_METHOD CM_adc20_engineering "wire to physical" LINEAR "%16.7" "A" COEFFS_LINEAR 1 0 /end COMPU_METHOD
/begin CHARACTERISTIC adc20_engineering "Motor 3 phase B current; engineering_A = raw * gain + offset; defaults=(VREF/2 - raw*VREF/4096)/(20*0.001); R48=1mΩ; DRV inverting CSA assumed20V/V and VREF/2 bias; nominal3.3V ADC ref; consult adc flags" VALUE 0x1340 RL_FLOAT32_IEEE 0 CM_adc20_engineering -1000000000.0 1000000000.0 STEP_SIZE 1e-06 READ_ONLY /end CHARACTERISTIC
/begin COMPU_METHOD CM_adc20_gain "wire to physical" LINEAR "%16.7" "A/count" COEFFS_LINEAR 1 0 /end COMPU_METHOD
/begin CHARACTERISTIC adc20_gain "Editable RAM gain; engineering_A = raw * gain + offset; defaults=(VREF/2 - raw*VREF/4096)/(20*0.001)" VALUE 0x1344 RL_FLOAT32_IEEE 0 CM_adc20_gain -10000 10000 STEP_SIZE 1e-06
 /begin ANNOTATION ANNOTATION_LABEL "CALIBRATION_PERSIST"
  /begin ANNOTATION_TEXT "RAM edit; explicit Save atomically stores whole LED and ADC calibration" /end ANNOTATION_TEXT
 /end ANNOTATION
/end CHARACTERISTIC
/begin COMPU_METHOD CM_adc20_offset "wire to physical" LINEAR "%16.7" "A" COEFFS_LINEAR 1 0 /end COMPU_METHOD
/begin CHARACTERISTIC adc20_offset "Editable RAM offset; engineering_A = raw * gain + offset; defaults=(VREF/2 - raw*VREF/4096)/(20*0.001)" VALUE 0x1348 RL_FLOAT32_IEEE 0 CM_adc20_offset -1000000.0 1000000.0 STEP_SIZE 1e-06
 /begin ANNOTATION ANNOTATION_LABEL "CALIBRATION_PERSIST"
  /begin ANNOTATION_TEXT "RAM edit; explicit Save atomically stores whole LED and ADC calibration" /end ANNOTATION_TEXT
 /end ANNOTATION
/end CHARACTERISTIC
/begin COMPU_METHOD CM_adc20_flags "wire to physical" LINEAR "%16.7" "" COEFFS_LINEAR 1 0 /end COMPU_METHOD
/begin CHARACTERISTIC adc20_flags "Flags1 valid2 rail4 spare8 CSA unverified16 nominal32 stale64 Celsius unknown128 invalid" VALUE 0x134c RL_UWORD 0 CM_adc20_flags 0 255 STEP_SIZE 1 READ_ONLY /end CHARACTERISTIC
/begin COMPU_METHOD CM_adc21_engineering "wire to physical" LINEAR "%16.7" "V" COEFFS_LINEAR 1 0 /end COMPU_METHOD
/begin CHARACTERISTIC adc21_engineering "Motor 1 phase C voltage estimate; engineering_V = raw*gain+offset; nominal11*Vadc. Exact ground-referenced phase voltage=11*Vadc-10*V_LS.; R79=33k/R80=3.3k; 11x divider; lower resistor returns to LS source, not GND; consult adc flags" VALUE 0x1350 RL_FLOAT32_IEEE 0 CM_adc21_engineering -1000000000.0 1000000000.0 STEP_SIZE 1e-06 READ_ONLY /end CHARACTERISTIC
/begin COMPU_METHOD CM_adc21_gain "wire to physical" LINEAR "%16.7" "V/count" COEFFS_LINEAR 1 0 /end COMPU_METHOD
/begin CHARACTERISTIC adc21_gain "Editable RAM gain; engineering_V = raw*gain+offset; nominal11*Vadc. Exact ground-referenced phase voltage=11*Vadc-10*V_LS." VALUE 0x1354 RL_FLOAT32_IEEE 0 CM_adc21_gain -10000 10000 STEP_SIZE 1e-06
 /begin ANNOTATION ANNOTATION_LABEL "CALIBRATION_PERSIST"
  /begin ANNOTATION_TEXT "RAM edit; explicit Save atomically stores whole LED and ADC calibration" /end ANNOTATION_TEXT
 /end ANNOTATION
/end CHARACTERISTIC
/begin COMPU_METHOD CM_adc21_offset "wire to physical" LINEAR "%16.7" "V" COEFFS_LINEAR 1 0 /end COMPU_METHOD
/begin CHARACTERISTIC adc21_offset "Editable RAM offset; engineering_V = raw*gain+offset; nominal11*Vadc. Exact ground-referenced phase voltage=11*Vadc-10*V_LS." VALUE 0x1358 RL_FLOAT32_IEEE 0 CM_adc21_offset -1000000.0 1000000.0 STEP_SIZE 1e-06
 /begin ANNOTATION ANNOTATION_LABEL "CALIBRATION_PERSIST"
  /begin ANNOTATION_TEXT "RAM edit; explicit Save atomically stores whole LED and ADC calibration" /end ANNOTATION_TEXT
 /end ANNOTATION
/end CHARACTERISTIC
/begin COMPU_METHOD CM_adc21_flags "wire to physical" LINEAR "%16.7" "" COEFFS_LINEAR 1 0 /end COMPU_METHOD
/begin CHARACTERISTIC adc21_flags "Flags1 valid2 rail4 spare8 CSA unverified16 nominal32 stale64 Celsius unknown128 invalid" VALUE 0x135c RL_UWORD 0 CM_adc21_flags 0 255 STEP_SIZE 1 READ_ONLY /end CHARACTERISTIC
/begin COMPU_METHOD CM_adc22_engineering "wire to physical" LINEAR "%16.7" "V" COEFFS_LINEAR 1 0 /end COMPU_METHOD
/begin CHARACTERISTIC adc22_engineering "Motor 4 phase C voltage estimate; engineering_V = raw*gain+offset; nominal11*Vadc. Exact ground-referenced phase voltage=11*Vadc-10*V_LS.; R34=33k/R35=3.3k; 11x divider; lower resistor returns to LS source, not GND; consult adc flags" VALUE 0x1360 RL_FLOAT32_IEEE 0 CM_adc22_engineering -1000000000.0 1000000000.0 STEP_SIZE 1e-06 READ_ONLY /end CHARACTERISTIC
/begin COMPU_METHOD CM_adc22_gain "wire to physical" LINEAR "%16.7" "V/count" COEFFS_LINEAR 1 0 /end COMPU_METHOD
/begin CHARACTERISTIC adc22_gain "Editable RAM gain; engineering_V = raw*gain+offset; nominal11*Vadc. Exact ground-referenced phase voltage=11*Vadc-10*V_LS." VALUE 0x1364 RL_FLOAT32_IEEE 0 CM_adc22_gain -10000 10000 STEP_SIZE 1e-06
 /begin ANNOTATION ANNOTATION_LABEL "CALIBRATION_PERSIST"
  /begin ANNOTATION_TEXT "RAM edit; explicit Save atomically stores whole LED and ADC calibration" /end ANNOTATION_TEXT
 /end ANNOTATION
/end CHARACTERISTIC
/begin COMPU_METHOD CM_adc22_offset "wire to physical" LINEAR "%16.7" "V" COEFFS_LINEAR 1 0 /end COMPU_METHOD
/begin CHARACTERISTIC adc22_offset "Editable RAM offset; engineering_V = raw*gain+offset; nominal11*Vadc. Exact ground-referenced phase voltage=11*Vadc-10*V_LS." VALUE 0x1368 RL_FLOAT32_IEEE 0 CM_adc22_offset -1000000.0 1000000.0 STEP_SIZE 1e-06
 /begin ANNOTATION ANNOTATION_LABEL "CALIBRATION_PERSIST"
  /begin ANNOTATION_TEXT "RAM edit; explicit Save atomically stores whole LED and ADC calibration" /end ANNOTATION_TEXT
 /end ANNOTATION
/end CHARACTERISTIC
/begin COMPU_METHOD CM_adc22_flags "wire to physical" LINEAR "%16.7" "" COEFFS_LINEAR 1 0 /end COMPU_METHOD
/begin CHARACTERISTIC adc22_flags "Flags1 valid2 rail4 spare8 CSA unverified16 nominal32 stale64 Celsius unknown128 invalid" VALUE 0x136c RL_UWORD 0 CM_adc22_flags 0 255 STEP_SIZE 1 READ_ONLY /end CHARACTERISTIC
/begin COMPU_METHOD CM_adc23_engineering "wire to physical" LINEAR "%16.7" "A" COEFFS_LINEAR 1 0 /end COMPU_METHOD
/begin CHARACTERISTIC adc23_engineering "Motor 1 phase C current; engineering_A = raw * gain + offset; defaults=(VREF/2 - raw*VREF/4096)/(20*0.001); R83=1mΩ; DRV inverting CSA assumed20V/V and VREF/2 bias; nominal3.3V ADC ref; consult adc flags" VALUE 0x1370 RL_FLOAT32_IEEE 0 CM_adc23_engineering -1000000000.0 1000000000.0 STEP_SIZE 1e-06 READ_ONLY /end CHARACTERISTIC
/begin COMPU_METHOD CM_adc23_gain "wire to physical" LINEAR "%16.7" "A/count" COEFFS_LINEAR 1 0 /end COMPU_METHOD
/begin CHARACTERISTIC adc23_gain "Editable RAM gain; engineering_A = raw * gain + offset; defaults=(VREF/2 - raw*VREF/4096)/(20*0.001)" VALUE 0x1374 RL_FLOAT32_IEEE 0 CM_adc23_gain -10000 10000 STEP_SIZE 1e-06
 /begin ANNOTATION ANNOTATION_LABEL "CALIBRATION_PERSIST"
  /begin ANNOTATION_TEXT "RAM edit; explicit Save atomically stores whole LED and ADC calibration" /end ANNOTATION_TEXT
 /end ANNOTATION
/end CHARACTERISTIC
/begin COMPU_METHOD CM_adc23_offset "wire to physical" LINEAR "%16.7" "A" COEFFS_LINEAR 1 0 /end COMPU_METHOD
/begin CHARACTERISTIC adc23_offset "Editable RAM offset; engineering_A = raw * gain + offset; defaults=(VREF/2 - raw*VREF/4096)/(20*0.001)" VALUE 0x1378 RL_FLOAT32_IEEE 0 CM_adc23_offset -1000000.0 1000000.0 STEP_SIZE 1e-06
 /begin ANNOTATION ANNOTATION_LABEL "CALIBRATION_PERSIST"
  /begin ANNOTATION_TEXT "RAM edit; explicit Save atomically stores whole LED and ADC calibration" /end ANNOTATION_TEXT
 /end ANNOTATION
/end CHARACTERISTIC
/begin COMPU_METHOD CM_adc23_flags "wire to physical" LINEAR "%16.7" "" COEFFS_LINEAR 1 0 /end COMPU_METHOD
/begin CHARACTERISTIC adc23_flags "Flags1 valid2 rail4 spare8 CSA unverified16 nominal32 stale64 Celsius unknown128 invalid" VALUE 0x137c RL_UWORD 0 CM_adc23_flags 0 255 STEP_SIZE 1 READ_ONLY /end CHARACTERISTIC
/begin COMPU_METHOD CM_adc24_engineering "wire to physical" LINEAR "%16.7" "A" COEFFS_LINEAR 1 0 /end COMPU_METHOD
/begin CHARACTERISTIC adc24_engineering "Motor 3 phase C current; engineering_A = raw * gain + offset; defaults=(VREF/2 - raw*VREF/4096)/(20*0.001); R53=1mΩ; DRV inverting CSA assumed20V/V and VREF/2 bias; nominal3.3V ADC ref; consult adc flags" VALUE 0x1380 RL_FLOAT32_IEEE 0 CM_adc24_engineering -1000000000.0 1000000000.0 STEP_SIZE 1e-06 READ_ONLY /end CHARACTERISTIC
/begin COMPU_METHOD CM_adc24_gain "wire to physical" LINEAR "%16.7" "A/count" COEFFS_LINEAR 1 0 /end COMPU_METHOD
/begin CHARACTERISTIC adc24_gain "Editable RAM gain; engineering_A = raw * gain + offset; defaults=(VREF/2 - raw*VREF/4096)/(20*0.001)" VALUE 0x1384 RL_FLOAT32_IEEE 0 CM_adc24_gain -10000 10000 STEP_SIZE 1e-06
 /begin ANNOTATION ANNOTATION_LABEL "CALIBRATION_PERSIST"
  /begin ANNOTATION_TEXT "RAM edit; explicit Save atomically stores whole LED and ADC calibration" /end ANNOTATION_TEXT
 /end ANNOTATION
/end CHARACTERISTIC
/begin COMPU_METHOD CM_adc24_offset "wire to physical" LINEAR "%16.7" "A" COEFFS_LINEAR 1 0 /end COMPU_METHOD
/begin CHARACTERISTIC adc24_offset "Editable RAM offset; engineering_A = raw * gain + offset; defaults=(VREF/2 - raw*VREF/4096)/(20*0.001)" VALUE 0x1388 RL_FLOAT32_IEEE 0 CM_adc24_offset -1000000.0 1000000.0 STEP_SIZE 1e-06
 /begin ANNOTATION ANNOTATION_LABEL "CALIBRATION_PERSIST"
  /begin ANNOTATION_TEXT "RAM edit; explicit Save atomically stores whole LED and ADC calibration" /end ANNOTATION_TEXT
 /end ANNOTATION
/end CHARACTERISTIC
/begin COMPU_METHOD CM_adc24_flags "wire to physical" LINEAR "%16.7" "" COEFFS_LINEAR 1 0 /end COMPU_METHOD
/begin CHARACTERISTIC adc24_flags "Flags1 valid2 rail4 spare8 CSA unverified16 nominal32 stale64 Celsius unknown128 invalid" VALUE 0x138c RL_UWORD 0 CM_adc24_flags 0 255 STEP_SIZE 1 READ_ONLY /end CHARACTERISTIC
/begin COMPU_METHOD CM_adc25_engineering "wire to physical" LINEAR "%16.7" "V" COEFFS_LINEAR 1 0 /end COMPU_METHOD
/begin CHARACTERISTIC adc25_engineering "Motor 3 phase C voltage estimate; engineering_V = raw*gain+offset; nominal11*Vadc. Exact ground-referenced phase voltage=11*Vadc-10*V_LS.; R49=33k/R50=3.3k; 11x divider; lower resistor returns to LS source, not GND; consult adc flags" VALUE 0x1390 RL_FLOAT32_IEEE 0 CM_adc25_engineering -1000000000.0 1000000000.0 STEP_SIZE 1e-06 READ_ONLY /end CHARACTERISTIC
/begin COMPU_METHOD CM_adc25_gain "wire to physical" LINEAR "%16.7" "V/count" COEFFS_LINEAR 1 0 /end COMPU_METHOD
/begin CHARACTERISTIC adc25_gain "Editable RAM gain; engineering_V = raw*gain+offset; nominal11*Vadc. Exact ground-referenced phase voltage=11*Vadc-10*V_LS." VALUE 0x1394 RL_FLOAT32_IEEE 0 CM_adc25_gain -10000 10000 STEP_SIZE 1e-06
 /begin ANNOTATION ANNOTATION_LABEL "CALIBRATION_PERSIST"
  /begin ANNOTATION_TEXT "RAM edit; explicit Save atomically stores whole LED and ADC calibration" /end ANNOTATION_TEXT
 /end ANNOTATION
/end CHARACTERISTIC
/begin COMPU_METHOD CM_adc25_offset "wire to physical" LINEAR "%16.7" "V" COEFFS_LINEAR 1 0 /end COMPU_METHOD
/begin CHARACTERISTIC adc25_offset "Editable RAM offset; engineering_V = raw*gain+offset; nominal11*Vadc. Exact ground-referenced phase voltage=11*Vadc-10*V_LS." VALUE 0x1398 RL_FLOAT32_IEEE 0 CM_adc25_offset -1000000.0 1000000.0 STEP_SIZE 1e-06
 /begin ANNOTATION ANNOTATION_LABEL "CALIBRATION_PERSIST"
  /begin ANNOTATION_TEXT "RAM edit; explicit Save atomically stores whole LED and ADC calibration" /end ANNOTATION_TEXT
 /end ANNOTATION
/end CHARACTERISTIC
/begin COMPU_METHOD CM_adc25_flags "wire to physical" LINEAR "%16.7" "" COEFFS_LINEAR 1 0 /end COMPU_METHOD
/begin CHARACTERISTIC adc25_flags "Flags1 valid2 rail4 spare8 CSA unverified16 nominal32 stale64 Celsius unknown128 invalid" VALUE 0x139c RL_UWORD 0 CM_adc25_flags 0 255 STEP_SIZE 1 READ_ONLY /end CHARACTERISTIC
/begin COMPU_METHOD CM_adc26_engineering "wire to physical" LINEAR "%16.7" "A" COEFFS_LINEAR 1 0 /end COMPU_METHOD
/begin CHARACTERISTIC adc26_engineering "Motor 2 phase C current; engineering_A = raw * gain + offset; defaults=(VREF/2 - raw*VREF/4096)/(20*0.001); R68=1mΩ; DRV inverting CSA assumed20V/V and VREF/2 bias; nominal3.3V ADC ref; consult adc flags" VALUE 0x13a0 RL_FLOAT32_IEEE 0 CM_adc26_engineering -1000000000.0 1000000000.0 STEP_SIZE 1e-06 READ_ONLY /end CHARACTERISTIC
/begin COMPU_METHOD CM_adc26_gain "wire to physical" LINEAR "%16.7" "A/count" COEFFS_LINEAR 1 0 /end COMPU_METHOD
/begin CHARACTERISTIC adc26_gain "Editable RAM gain; engineering_A = raw * gain + offset; defaults=(VREF/2 - raw*VREF/4096)/(20*0.001)" VALUE 0x13a4 RL_FLOAT32_IEEE 0 CM_adc26_gain -10000 10000 STEP_SIZE 1e-06
 /begin ANNOTATION ANNOTATION_LABEL "CALIBRATION_PERSIST"
  /begin ANNOTATION_TEXT "RAM edit; explicit Save atomically stores whole LED and ADC calibration" /end ANNOTATION_TEXT
 /end ANNOTATION
/end CHARACTERISTIC
/begin COMPU_METHOD CM_adc26_offset "wire to physical" LINEAR "%16.7" "A" COEFFS_LINEAR 1 0 /end COMPU_METHOD
/begin CHARACTERISTIC adc26_offset "Editable RAM offset; engineering_A = raw * gain + offset; defaults=(VREF/2 - raw*VREF/4096)/(20*0.001)" VALUE 0x13a8 RL_FLOAT32_IEEE 0 CM_adc26_offset -1000000.0 1000000.0 STEP_SIZE 1e-06
 /begin ANNOTATION ANNOTATION_LABEL "CALIBRATION_PERSIST"
  /begin ANNOTATION_TEXT "RAM edit; explicit Save atomically stores whole LED and ADC calibration" /end ANNOTATION_TEXT
 /end ANNOTATION
/end CHARACTERISTIC
/begin COMPU_METHOD CM_adc26_flags "wire to physical" LINEAR "%16.7" "" COEFFS_LINEAR 1 0 /end COMPU_METHOD
/begin CHARACTERISTIC adc26_flags "Flags1 valid2 rail4 spare8 CSA unverified16 nominal32 stale64 Celsius unknown128 invalid" VALUE 0x13ac RL_UWORD 0 CM_adc26_flags 0 255 STEP_SIZE 1 READ_ONLY /end CHARACTERISTIC
/begin COMPU_METHOD CM_adc27_engineering "wire to physical" LINEAR "%16.7" "V" COEFFS_LINEAR 1 0 /end COMPU_METHOD
/begin CHARACTERISTIC adc27_engineering "Motor 2 phase C voltage estimate; engineering_V = raw*gain+offset; nominal11*Vadc. Exact ground-referenced phase voltage=11*Vadc-10*V_LS.; R64=33k/R65=3.3k; 11x divider; lower resistor returns to LS source, not GND; consult adc flags" VALUE 0x13b0 RL_FLOAT32_IEEE 0 CM_adc27_engineering -1000000000.0 1000000000.0 STEP_SIZE 1e-06 READ_ONLY /end CHARACTERISTIC
/begin COMPU_METHOD CM_adc27_gain "wire to physical" LINEAR "%16.7" "V/count" COEFFS_LINEAR 1 0 /end COMPU_METHOD
/begin CHARACTERISTIC adc27_gain "Editable RAM gain; engineering_V = raw*gain+offset; nominal11*Vadc. Exact ground-referenced phase voltage=11*Vadc-10*V_LS." VALUE 0x13b4 RL_FLOAT32_IEEE 0 CM_adc27_gain -10000 10000 STEP_SIZE 1e-06
 /begin ANNOTATION ANNOTATION_LABEL "CALIBRATION_PERSIST"
  /begin ANNOTATION_TEXT "RAM edit; explicit Save atomically stores whole LED and ADC calibration" /end ANNOTATION_TEXT
 /end ANNOTATION
/end CHARACTERISTIC
/begin COMPU_METHOD CM_adc27_offset "wire to physical" LINEAR "%16.7" "V" COEFFS_LINEAR 1 0 /end COMPU_METHOD
/begin CHARACTERISTIC adc27_offset "Editable RAM offset; engineering_V = raw*gain+offset; nominal11*Vadc. Exact ground-referenced phase voltage=11*Vadc-10*V_LS." VALUE 0x13b8 RL_FLOAT32_IEEE 0 CM_adc27_offset -1000000.0 1000000.0 STEP_SIZE 1e-06
 /begin ANNOTATION ANNOTATION_LABEL "CALIBRATION_PERSIST"
  /begin ANNOTATION_TEXT "RAM edit; explicit Save atomically stores whole LED and ADC calibration" /end ANNOTATION_TEXT
 /end ANNOTATION
/end CHARACTERISTIC
/begin COMPU_METHOD CM_adc27_flags "wire to physical" LINEAR "%16.7" "" COEFFS_LINEAR 1 0 /end COMPU_METHOD
/begin CHARACTERISTIC adc27_flags "Flags1 valid2 rail4 spare8 CSA unverified16 nominal32 stale64 Celsius unknown128 invalid" VALUE 0x13bc RL_UWORD 0 CM_adc27_flags 0 255 STEP_SIZE 1 READ_ONLY /end CHARACTERISTIC
/begin COMPU_METHOD CM_adc28_engineering "wire to physical" LINEAR "%16.7" "A" COEFFS_LINEAR 1 0 /end COMPU_METHOD
/begin CHARACTERISTIC adc28_engineering "Motor 4 phase C current; engineering_A = raw * gain + offset; defaults=(VREF/2 - raw*VREF/4096)/(20*0.001); R38=1mΩ; DRV inverting CSA assumed20V/V and VREF/2 bias; nominal3.3V ADC ref; consult adc flags" VALUE 0x13c0 RL_FLOAT32_IEEE 0 CM_adc28_engineering -1000000000.0 1000000000.0 STEP_SIZE 1e-06 READ_ONLY /end CHARACTERISTIC
/begin COMPU_METHOD CM_adc28_gain "wire to physical" LINEAR "%16.7" "A/count" COEFFS_LINEAR 1 0 /end COMPU_METHOD
/begin CHARACTERISTIC adc28_gain "Editable RAM gain; engineering_A = raw * gain + offset; defaults=(VREF/2 - raw*VREF/4096)/(20*0.001)" VALUE 0x13c4 RL_FLOAT32_IEEE 0 CM_adc28_gain -10000 10000 STEP_SIZE 1e-06
 /begin ANNOTATION ANNOTATION_LABEL "CALIBRATION_PERSIST"
  /begin ANNOTATION_TEXT "RAM edit; explicit Save atomically stores whole LED and ADC calibration" /end ANNOTATION_TEXT
 /end ANNOTATION
/end CHARACTERISTIC
/begin COMPU_METHOD CM_adc28_offset "wire to physical" LINEAR "%16.7" "A" COEFFS_LINEAR 1 0 /end COMPU_METHOD
/begin CHARACTERISTIC adc28_offset "Editable RAM offset; engineering_A = raw * gain + offset; defaults=(VREF/2 - raw*VREF/4096)/(20*0.001)" VALUE 0x13c8 RL_FLOAT32_IEEE 0 CM_adc28_offset -1000000.0 1000000.0 STEP_SIZE 1e-06
 /begin ANNOTATION ANNOTATION_LABEL "CALIBRATION_PERSIST"
  /begin ANNOTATION_TEXT "RAM edit; explicit Save atomically stores whole LED and ADC calibration" /end ANNOTATION_TEXT
 /end ANNOTATION
/end CHARACTERISTIC
/begin COMPU_METHOD CM_adc28_flags "wire to physical" LINEAR "%16.7" "" COEFFS_LINEAR 1 0 /end COMPU_METHOD
/begin CHARACTERISTIC adc28_flags "Flags1 valid2 rail4 spare8 CSA unverified16 nominal32 stale64 Celsius unknown128 invalid" VALUE 0x13cc RL_UWORD 0 CM_adc28_flags 0 255 STEP_SIZE 1 READ_ONLY /end CHARACTERISTIC
/begin COMPU_METHOD CM_adc29_engineering "wire to physical" LINEAR "%16.7" "V" COEFFS_LINEAR 1 0 /end COMPU_METHOD
/begin CHARACTERISTIC adc29_engineering "Battery voltage; engineering_V = raw*gain+offset; gain=(3.3/4096)*(104700/4700); R19=100k/R21=4.7k; exact ratio104700/4700, nominal3.3V ADC reference; consult adc flags" VALUE 0x13d0 RL_FLOAT32_IEEE 0 CM_adc29_engineering -1000000000.0 1000000000.0 STEP_SIZE 1e-06 READ_ONLY /end CHARACTERISTIC
/begin COMPU_METHOD CM_adc29_gain "wire to physical" LINEAR "%16.7" "V/count" COEFFS_LINEAR 1 0 /end COMPU_METHOD
/begin CHARACTERISTIC adc29_gain "Editable RAM gain; engineering_V = raw*gain+offset; gain=(3.3/4096)*(104700/4700)" VALUE 0x13d4 RL_FLOAT32_IEEE 0 CM_adc29_gain -10000 10000 STEP_SIZE 1e-06
 /begin ANNOTATION ANNOTATION_LABEL "CALIBRATION_PERSIST"
  /begin ANNOTATION_TEXT "RAM edit; explicit Save atomically stores whole LED and ADC calibration" /end ANNOTATION_TEXT
 /end ANNOTATION
/end CHARACTERISTIC
/begin COMPU_METHOD CM_adc29_offset "wire to physical" LINEAR "%16.7" "V" COEFFS_LINEAR 1 0 /end COMPU_METHOD
/begin CHARACTERISTIC adc29_offset "Editable RAM offset; engineering_V = raw*gain+offset; gain=(3.3/4096)*(104700/4700)" VALUE 0x13d8 RL_FLOAT32_IEEE 0 CM_adc29_offset -1000000.0 1000000.0 STEP_SIZE 1e-06
 /begin ANNOTATION ANNOTATION_LABEL "CALIBRATION_PERSIST"
  /begin ANNOTATION_TEXT "RAM edit; explicit Save atomically stores whole LED and ADC calibration" /end ANNOTATION_TEXT
 /end ANNOTATION
/end CHARACTERISTIC
/begin COMPU_METHOD CM_adc29_flags "wire to physical" LINEAR "%16.7" "" COEFFS_LINEAR 1 0 /end COMPU_METHOD
/begin CHARACTERISTIC adc29_flags "Flags1 valid2 rail4 spare8 CSA unverified16 nominal32 stale64 Celsius unknown128 invalid" VALUE 0x13dc RL_UWORD 0 CM_adc29_flags 0 255 STEP_SIZE 1 READ_ONLY /end CHARACTERISTIC
/begin COMPU_METHOD CM_reboot_action "wire to physical" LINEAR "%16.7" "" COEFFS_LINEAR 1 0 /end COMPU_METHOD
/begin CHARACTERISTIC reboot_action "Write1: inhibit PWM/drivers, acknowledge over CAN, then reset into ABI1 loader3s window. Reads0; no Save; no automatic retry. Loader CAN-FD IDs710/711." VALUE 0x1400 RL_UWORD 0 CM_reboot_action 0 1 STEP_SIZE 1
 /begin ANNOTATION ANNOTATION_LABEL "XCP_UI_COMMAND" /begin ANNOTATION_TEXT "execute-last; no-save; self-clearing" /end ANNOTATION_TEXT /end ANNOTATION
/end CHARACTERISTIC
/begin COMPU_METHOD CM_pwm_applied_route_mask "wire to physical" LINEAR "%16.7" "" COEFFS_LINEAR 1 0 /end COMPU_METHOD
/begin CHARACTERISTIC pwm_applied_route_mask "Applied PWM route bits; all motor phases=0x1fbf excludes6; zero on stop, safeoff, invalidation or failure. Applied does not imply running." VALUE 0x1404 RL_ULONG 0 CM_pwm_applied_route_mask 0 8191 STEP_SIZE 1 READ_ONLY /end CHARACTERISTIC
/begin COMPU_METHOD CM_adc_diag_mode "wire to physical" LINEAR "%16.7" "" COEFFS_LINEAR 1 0 /end COMPU_METHOD
/begin CHARACTERISTIC adc_diag_mode "Volatile diagnostic mode" VALUE 0x141c RL_ULONG 0 CM_adc_diag_mode 0 1 STEP_SIZE 1 /end CHARACTERISTIC
/begin COMPU_METHOD CM_adc_diag_channel "wire to physical" LINEAR "%16.7" "" COEFFS_LINEAR 1 0 /end COMPU_METHOD
/begin CHARACTERISTIC adc_diag_channel "Volatile diagnostic channel" VALUE 0x1420 RL_ULONG 0 CM_adc_diag_channel 0 3 STEP_SIZE 1 /end CHARACTERISTIC
/begin COMPU_METHOD CM_adc_diag_offset_ticks "wire to physical" LINEAR "%16.7" "" COEFFS_LINEAR 1 0 /end COMPU_METHOD
/begin CHARACTERISTIC adc_diag_offset_ticks "Volatile diagnostic offset_ticks" VALUE 0x1424 RL_ULONG 0 CM_adc_diag_offset_ticks 0 1599 STEP_SIZE 1 /end CHARACTERISTIC
/begin COMPU_METHOD CM_adc_diag_window_cycles "wire to physical" LINEAR "%16.7" "" COEFFS_LINEAR 1 0 /end COMPU_METHOD
/begin CHARACTERISTIC adc_diag_window_cycles "Volatile diagnostic window_cycles" VALUE 0x1428 RL_ULONG 0 CM_adc_diag_window_cycles 0 448 STEP_SIZE 1 /end CHARACTERISTIC
/begin COMPU_METHOD CM_adc_diag_samples "wire to physical" LINEAR "%16.7" "" COEFFS_LINEAR 1 0 /end COMPU_METHOD
/begin CHARACTERISTIC adc_diag_samples "Volatile diagnostic samples" VALUE 0x142c RL_ULONG 0 CM_adc_diag_samples 0 8192 STEP_SIZE 1 /end CHARACTERISTIC
/begin COMPU_METHOD CM_adc_diag_center "wire to physical" LINEAR "%16.7" "" COEFFS_LINEAR 1 0 /end COMPU_METHOD
/begin CHARACTERISTIC adc_diag_center "Volatile diagnostic center" VALUE 0x1430 RL_ULONG 0 CM_adc_diag_center 0 4095 STEP_SIZE 1 /end CHARACTERISTIC
/begin COMPU_METHOD CM_adc_diag_deviation "wire to physical" LINEAR "%16.7" "" COEFFS_LINEAR 1 0 /end COMPU_METHOD
/begin CHARACTERISTIC adc_diag_deviation "Volatile diagnostic deviation" VALUE 0x1434 RL_ULONG 0 CM_adc_diag_deviation 0 4095 STEP_SIZE 1 /end CHARACTERISTIC
/begin COMPU_METHOD CM_adc_diag_action "wire to physical" LINEAR "%16.7" "" COEFFS_LINEAR 1 0 /end COMPU_METHOD
/begin CHARACTERISTIC adc_diag_action "Diagnostic staged configuration; action 1 start, 2 cancel/safeoff; channel 0..3=M1..M4; mode 0 software/1 PWM0 CMPC SOCA; windows 128/256/448 only; frozen raw cursor only after completion" VALUE 0x1438 RL_ULONG 0 CM_adc_diag_action 0 2 STEP_SIZE 1
 /begin ANNOTATION ANNOTATION_LABEL "XCP_UI_COMMAND" /begin ANNOTATION_TEXT "execute-last; no-save; self-clearing" /end ANNOTATION_TEXT /end ANNOTATION
/end CHARACTERISTIC
/begin COMPU_METHOD CM_adc_diag_cursor "wire to physical" LINEAR "%16.7" "" COEFFS_LINEAR 1 0 /end COMPU_METHOD
/begin CHARACTERISTIC adc_diag_cursor "Frozen raw index 0..min(count,2048)-1 (first samples); 8192..8223 selects histogram bins. Bins floor((raw-center+256)/16) clamped 0..31, tails included." VALUE 0x143c RL_ULONG 0 CM_adc_diag_cursor 0 8223 STEP_SIZE 1 /end CHARACTERISTIC
/begin COMPU_METHOD CM_adc_diag_status "wire to physical" LINEAR "%16.7" "" COEFFS_LINEAR 1 0 /end COMPU_METHOD
/begin CHARACTERISTIC adc_diag_status "Diagnostic status; status 0 idle/1 running/2 complete/3 canceled/4 error; counters are sequential, NOT simultaneous; raw is selected frozen capture sample" VALUE 0x1440 RL_ULONG 0 CM_adc_diag_status 0 4294967295 STEP_SIZE 1 READ_ONLY /end CHARACTERISTIC
/begin COMPU_METHOD CM_adc_diag_sequence "wire to physical" LINEAR "%16.7" "" COEFFS_LINEAR 1 0 /end COMPU_METHOD
/begin CHARACTERISTIC adc_diag_sequence "Diagnostic sequence; status 0 idle/1 running/2 complete/3 canceled/4 error; counters are sequential, NOT simultaneous; raw is selected frozen capture sample" VALUE 0x1444 RL_ULONG 0 CM_adc_diag_sequence 0 4294967295 STEP_SIZE 1 READ_ONLY /end CHARACTERISTIC
/begin COMPU_METHOD CM_adc_diag_count "wire to physical" LINEAR "%16.7" "" COEFFS_LINEAR 1 0 /end COMPU_METHOD
/begin CHARACTERISTIC adc_diag_count "Diagnostic count; status 0 idle/1 running/2 complete/3 canceled/4 error; counters are sequential, NOT simultaneous; raw is selected frozen capture sample" VALUE 0x1448 RL_ULONG 0 CM_adc_diag_count 0 4294967295 STEP_SIZE 1 READ_ONLY /end CHARACTERISTIC
/begin COMPU_METHOD CM_adc_diag_min "wire to physical" LINEAR "%16.7" "" COEFFS_LINEAR 1 0 /end COMPU_METHOD
/begin CHARACTERISTIC adc_diag_min "Diagnostic min; status 0 idle/1 running/2 complete/3 canceled/4 error; counters are sequential, NOT simultaneous; raw is selected frozen capture sample" VALUE 0x144c RL_ULONG 0 CM_adc_diag_min 0 4294967295 STEP_SIZE 1 READ_ONLY /end CHARACTERISTIC
/begin COMPU_METHOD CM_adc_diag_max "wire to physical" LINEAR "%16.7" "" COEFFS_LINEAR 1 0 /end COMPU_METHOD
/begin CHARACTERISTIC adc_diag_max "Diagnostic max; status 0 idle/1 running/2 complete/3 canceled/4 error; counters are sequential, NOT simultaneous; raw is selected frozen capture sample" VALUE 0x1450 RL_ULONG 0 CM_adc_diag_max 0 4294967295 STEP_SIZE 1 READ_ONLY /end CHARACTERISTIC
/begin COMPU_METHOD CM_adc_diag_sum "wire to physical" LINEAR "%16.7" "" COEFFS_LINEAR 1 0 /end COMPU_METHOD
/begin CHARACTERISTIC adc_diag_sum "Diagnostic sum; status 0 idle/1 running/2 complete/3 canceled/4 error; counters are sequential, NOT simultaneous; raw is selected frozen capture sample" VALUE 0x1454 RL_ULONG 0 CM_adc_diag_sum 0 4294967295 STEP_SIZE 1 READ_ONLY /end CHARACTERISTIC
/begin COMPU_METHOD CM_adc_diag_outliers "wire to physical" LINEAR "%16.7" "" COEFFS_LINEAR 1 0 /end COMPU_METHOD
/begin CHARACTERISTIC adc_diag_outliers "Diagnostic outliers; status 0 idle/1 running/2 complete/3 canceled/4 error; counters are sequential, NOT simultaneous; raw is selected frozen capture sample" VALUE 0x1458 RL_ULONG 0 CM_adc_diag_outliers 0 4294967295 STEP_SIZE 1 READ_ONLY /end CHARACTERISTIC
/begin COMPU_METHOD CM_adc_diag_duration_us "wire to physical" LINEAR "%16.7" "" COEFFS_LINEAR 1 0 /end COMPU_METHOD
/begin CHARACTERISTIC adc_diag_duration_us "Diagnostic duration_us; status 0 idle/1 running/2 complete/3 canceled/4 error; counters are sequential, NOT simultaneous; raw is selected frozen capture sample" VALUE 0x145c RL_ULONG 0 CM_adc_diag_duration_us 0 4294967295 STEP_SIZE 1 READ_ONLY /end CHARACTERISTIC
/begin COMPU_METHOD CM_adc_diag_raw "wire to physical" LINEAR "%16.7" "" COEFFS_LINEAR 1 0 /end COMPU_METHOD
/begin CHARACTERISTIC adc_diag_raw "Diagnostic raw; status 0 idle/1 running/2 complete/3 canceled/4 error; counters are sequential, NOT simultaneous; raw is selected frozen capture sample" VALUE 0x1460 RL_ULONG 0 CM_adc_diag_raw 0 4294967295 STEP_SIZE 1 READ_ONLY /end CHARACTERISTIC
/begin COMPU_METHOD CM_adc_diag_trigger_flags "wire to physical" LINEAR "%16.7" "" COEFFS_LINEAR 1 0 /end COMPU_METHOD
/begin CHARACTERISTIC adc_diag_trigger_flags "Diagnostic trigger_flags; status 0 idle/1 running/2 complete/3 canceled/4 error; counters are sequential, NOT simultaneous; raw is selected frozen capture sample" VALUE 0x1464 RL_ULONG 0 CM_adc_diag_trigger_flags 0 4294967295 STEP_SIZE 1 READ_ONLY /end CHARACTERISTIC
/begin COMPU_METHOD CM_adc_diag_eoc_counter "wire to physical" LINEAR "%16.7" "" COEFFS_LINEAR 1 0 /end COMPU_METHOD
/begin CHARACTERISTIC adc_diag_eoc_counter "Diagnostic eoc_counter; status 0 idle/1 running/2 complete/3 canceled/4 error; counters are sequential, NOT simultaneous; raw is selected frozen capture sample" VALUE 0x1468 RL_ULONG 0 CM_adc_diag_eoc_counter 0 4294967295 STEP_SIZE 1 READ_ONLY /end CHARACTERISTIC
/begin COMPU_METHOD CM_adc_diag_counter0_before "wire to physical" LINEAR "%16.7" "" COEFFS_LINEAR 1 0 /end COMPU_METHOD
/begin CHARACTERISTIC adc_diag_counter0_before "Diagnostic counter0_before; status 0 idle/1 running/2 complete/3 canceled/4 error; counters are sequential, NOT simultaneous; raw is selected frozen capture sample" VALUE 0x146c RL_ULONG 0 CM_adc_diag_counter0_before 0 4294967295 STEP_SIZE 1 READ_ONLY /end CHARACTERISTIC
/begin COMPU_METHOD CM_adc_diag_counter1 "wire to physical" LINEAR "%16.7" "" COEFFS_LINEAR 1 0 /end COMPU_METHOD
/begin CHARACTERISTIC adc_diag_counter1 "Diagnostic counter1; status 0 idle/1 running/2 complete/3 canceled/4 error; counters are sequential, NOT simultaneous; raw is selected frozen capture sample" VALUE 0x1470 RL_ULONG 0 CM_adc_diag_counter1 0 4294967295 STEP_SIZE 1 READ_ONLY /end CHARACTERISTIC
/begin COMPU_METHOD CM_adc_diag_counter2 "wire to physical" LINEAR "%16.7" "" COEFFS_LINEAR 1 0 /end COMPU_METHOD
/begin CHARACTERISTIC adc_diag_counter2 "Diagnostic counter2; status 0 idle/1 running/2 complete/3 canceled/4 error; counters are sequential, NOT simultaneous; raw is selected frozen capture sample" VALUE 0x1474 RL_ULONG 0 CM_adc_diag_counter2 0 4294967295 STEP_SIZE 1 READ_ONLY /end CHARACTERISTIC
/begin COMPU_METHOD CM_adc_diag_counter3 "wire to physical" LINEAR "%16.7" "" COEFFS_LINEAR 1 0 /end COMPU_METHOD
/begin CHARACTERISTIC adc_diag_counter3 "Diagnostic counter3; status 0 idle/1 running/2 complete/3 canceled/4 error; counters are sequential, NOT simultaneous; raw is selected frozen capture sample" VALUE 0x1478 RL_ULONG 0 CM_adc_diag_counter3 0 4294967295 STEP_SIZE 1 READ_ONLY /end CHARACTERISTIC
/begin COMPU_METHOD CM_adc_diag_counter0_after "wire to physical" LINEAR "%16.7" "" COEFFS_LINEAR 1 0 /end COMPU_METHOD
/begin CHARACTERISTIC adc_diag_counter0_after "Diagnostic counter0_after; status 0 idle/1 running/2 complete/3 canceled/4 error; counters are sequential, NOT simultaneous; raw is selected frozen capture sample" VALUE 0x147c RL_ULONG 0 CM_adc_diag_counter0_after 0 4294967295 STEP_SIZE 1 READ_ONLY /end CHARACTERISTIC
/begin COMPU_METHOD CM_thermal_sample_m1 "wire to physical" LINEAR "%16.7" "" COEFFS_LINEAR 1 0 /end COMPU_METHOD
/begin CHARACTERISTIC thermal_sample_m1 "Atomic fresh thermal sample: upper16 per-sensor sequence, lower16 raw (65535 invalid); updates during normal scan; sequence wraps" VALUE 0x1480 RL_ULONG 0 CM_thermal_sample_m1 0 4294967295 STEP_SIZE 1 READ_ONLY /end CHARACTERISTIC
/begin COMPU_METHOD CM_thermal_sample_m2 "wire to physical" LINEAR "%16.7" "" COEFFS_LINEAR 1 0 /end COMPU_METHOD
/begin CHARACTERISTIC thermal_sample_m2 "Atomic fresh thermal sample: upper16 per-sensor sequence, lower16 raw (65535 invalid); updates during normal scan; sequence wraps" VALUE 0x1484 RL_ULONG 0 CM_thermal_sample_m2 0 4294967295 STEP_SIZE 1 READ_ONLY /end CHARACTERISTIC
/begin COMPU_METHOD CM_thermal_sample_m3 "wire to physical" LINEAR "%16.7" "" COEFFS_LINEAR 1 0 /end COMPU_METHOD
/begin CHARACTERISTIC thermal_sample_m3 "Atomic fresh thermal sample: upper16 per-sensor sequence, lower16 raw (65535 invalid); updates during normal scan; sequence wraps" VALUE 0x1488 RL_ULONG 0 CM_thermal_sample_m3 0 4294967295 STEP_SIZE 1 READ_ONLY /end CHARACTERISTIC
/begin COMPU_METHOD CM_thermal_sample_m4 "wire to physical" LINEAR "%16.7" "" COEFFS_LINEAR 1 0 /end COMPU_METHOD
/begin CHARACTERISTIC thermal_sample_m4 "Atomic fresh thermal sample: upper16 per-sensor sequence, lower16 raw (65535 invalid); updates during normal scan; sequence wraps" VALUE 0x148c RL_ULONG 0 CM_thermal_sample_m4 0 4294967295 STEP_SIZE 1 READ_ONLY /end CHARACTERISTIC
/begin COMPU_METHOD CM_bench_offset_ticks "wire to physical" LINEAR "%16.7" "" COEFFS_LINEAR 1 0 /end COMPU_METHOD
/begin CHARACTERISTIC bench_offset_ticks "Staged PWM0 CMPC offset; frozen during run; pipeline not measured" VALUE 0x1490 RL_ULONG 0 CM_bench_offset_ticks 0 639 STEP_SIZE 1 /end CHARACTERISTIC
/begin COMPU_METHOD CM_bench_action "wire to physical" LINEAR "%16.7" "" COEFFS_LINEAR 1 0 /end COMPU_METHOD
/begin CHARACTERISTIC bench_action "1 start quadrature synchronous bench; 2 safe off; explicit rearm" VALUE 0x1494 RL_ULONG 0 CM_bench_action 0 2 STEP_SIZE 1
 /begin ANNOTATION ANNOTATION_LABEL "XCP_UI_COMMAND" /begin ANNOTATION_TEXT "execute-last; no-save; self-clearing" /end ANNOTATION_TEXT /end ANNOTATION
/end CHARACTERISTIC
/begin COMPU_METHOD CM_bench_status "wire to physical" LINEAR "%16.7" "" COEFFS_LINEAR 1 0 /end COMPU_METHOD
/begin CHARACTERISTIC bench_status "0 idle 1 running 3 stopped 4 error" VALUE 0x1498 RL_ULONG 0 CM_bench_status 0 4 STEP_SIZE 1 READ_ONLY /end CHARACTERISTIC
/begin COMPU_METHOD CM_bench_effective_mode "wire to physical" LINEAR "%16.7" "" COEFFS_LINEAR 1 0 /end COMPU_METHOD
/begin CHARACTERISTIC bench_effective_mode "1 quadrature plus continuous four thermistor hardware capture" VALUE 0x149c RL_ULONG 0 CM_bench_effective_mode 0 1 STEP_SIZE 1 READ_ONLY /end CHARACTERISTIC
/begin COMPU_METHOD CM_bench_channel_mask "wire to physical" LINEAR "%16.7" "" COEFFS_LINEAR 1 0 /end COMPU_METHOD
/begin CHARACTERISTIC bench_channel_mask "Exact ADC indexes hardware triggered; others software" VALUE 0x14a0 RL_ULONG 0 CM_bench_channel_mask 0 4294967295 STEP_SIZE 1 READ_ONLY /end CHARACTERISTIC
/begin COMPU_METHOD CM_bench_trigger "wire to physical" LINEAR "%16.7" "" COEFFS_LINEAR 1 0 /end COMPU_METHOD
/begin CHARACTERISTIC bench_trigger "ADC TRIGSEL6 PWM0 CMPC SOCA" VALUE 0x14a4 RL_ULONG 0 CM_bench_trigger 0 6 STEP_SIZE 1 READ_ONLY /end CHARACTERISTIC
/begin COMPU_METHOD CM_bench_window_cycles "wire to physical" LINEAR "%16.7" "" COEFFS_LINEAR 1 0 /end COMPU_METHOD
/begin CHARACTERISTIC bench_window_cycles "Effective acquisition MCLK cycles; bench128=4us" VALUE 0x14a8 RL_ULONG 0 CM_bench_window_cycles 0 448 STEP_SIZE 1 READ_ONLY /end CHARACTERISTIC
/begin COMPU_METHOD CM_bench_effective_offset "wire to physical" LINEAR "%16.7" "" COEFFS_LINEAR 1 0 /end COMPU_METHOD
/begin CHARACTERISTIC bench_effective_offset "Effective CMPC ticks" VALUE 0x14ac RL_ULONG 0 CM_bench_effective_offset 0 639 STEP_SIZE 1 READ_ONLY /end CHARACTERISTIC
/begin COMPU_METHOD CM_bench_elapsed_ms "wire to physical" LINEAR "%16.7" "" COEFFS_LINEAR 1 0 /end COMPU_METHOD
/begin CHARACTERISTIC bench_elapsed_ms "Nonrenewing elapsed run time; maximum330000ms" VALUE 0x14b0 RL_ULONG 0 CM_bench_elapsed_ms 0 330000 STEP_SIZE 1 READ_ONLY /end CHARACTERISTIC
/begin COMPU_METHOD CM_bench_lease_ms "wire to physical" LINEAR "%16.7" "" COEFFS_LINEAR 1 0 /end COMPU_METHOD
/begin CHARACTERISTIC bench_lease_ms "Remaining provider communication lease" VALUE 0x14b4 RL_ULONG 0 CM_bench_lease_ms 0 1500 STEP_SIZE 1 READ_ONLY /end CHARACTERISTIC
/begin COMPU_METHOD CM_bench_phase_status "wire to physical" LINEAR "%16.7" "" COEFFS_LINEAR 1 0 /end COMPU_METHOD
/begin CHARACTERISTIC bench_phase_status "1 common clock gate/preload readback passed; not physical phase proof" VALUE 0x14b8 RL_ULONG 0 CM_bench_phase_status 0 1 STEP_SIZE 1 READ_ONLY /end CHARACTERISTIC
/begin COMPU_METHOD CM_bench_preload_pwm0 "wire to physical" LINEAR "%16.7" "" COEFFS_LINEAR 1 0 /end COMPU_METHOD
/begin CHARACTERISTIC bench_preload_pwm0 "Readback counter while common clock gate stopped" VALUE 0x14bc RL_ULONG 0 CM_bench_preload_pwm0 0 639 STEP_SIZE 1 READ_ONLY /end CHARACTERISTIC
/begin COMPU_METHOD CM_bench_preload_pwm1 "wire to physical" LINEAR "%16.7" "" COEFFS_LINEAR 1 0 /end COMPU_METHOD
/begin CHARACTERISTIC bench_preload_pwm1 "Readback counter while common clock gate stopped" VALUE 0x14c0 RL_ULONG 0 CM_bench_preload_pwm1 0 639 STEP_SIZE 1 READ_ONLY /end CHARACTERISTIC
/begin COMPU_METHOD CM_bench_preload_pwm2 "wire to physical" LINEAR "%16.7" "" COEFFS_LINEAR 1 0 /end COMPU_METHOD
/begin CHARACTERISTIC bench_preload_pwm2 "Readback counter while common clock gate stopped" VALUE 0x14c4 RL_ULONG 0 CM_bench_preload_pwm2 0 639 STEP_SIZE 1 READ_ONLY /end CHARACTERISTIC
/begin COMPU_METHOD CM_bench_preload_pwm3 "wire to physical" LINEAR "%16.7" "" COEFFS_LINEAR 1 0 /end COMPU_METHOD
/begin CHARACTERISTIC bench_preload_pwm3 "Readback counter while common clock gate stopped" VALUE 0x14c8 RL_ULONG 0 CM_bench_preload_pwm3 0 639 STEP_SIZE 1 READ_ONLY /end CHARACTERISTIC
/begin COMPU_METHOD CM_bench_age_m1 "wire to physical" LINEAR "%16.7" "" COEFFS_LINEAR 1 0 /end COMPU_METHOD
/begin CHARACTERISTIC bench_age_m1 "Age of latest hardware thermistor conversion milliseconds" VALUE 0x14cc RL_ULONG 0 CM_bench_age_m1 0 4294967295 STEP_SIZE 1 READ_ONLY /end CHARACTERISTIC
/begin COMPU_METHOD CM_bench_age_m2 "wire to physical" LINEAR "%16.7" "" COEFFS_LINEAR 1 0 /end COMPU_METHOD
/begin CHARACTERISTIC bench_age_m2 "Age of latest hardware thermistor conversion milliseconds" VALUE 0x14d0 RL_ULONG 0 CM_bench_age_m2 0 4294967295 STEP_SIZE 1 READ_ONLY /end CHARACTERISTIC
/begin COMPU_METHOD CM_bench_age_m3 "wire to physical" LINEAR "%16.7" "" COEFFS_LINEAR 1 0 /end COMPU_METHOD
/begin CHARACTERISTIC bench_age_m3 "Age of latest hardware thermistor conversion milliseconds" VALUE 0x14d4 RL_ULONG 0 CM_bench_age_m3 0 4294967295 STEP_SIZE 1 READ_ONLY /end CHARACTERISTIC
/begin COMPU_METHOD CM_bench_age_m4 "wire to physical" LINEAR "%16.7" "" COEFFS_LINEAR 1 0 /end COMPU_METHOD
/begin CHARACTERISTIC bench_age_m4 "Age of latest hardware thermistor conversion milliseconds" VALUE 0x14d8 RL_ULONG 0 CM_bench_age_m4 0 4294967295 STEP_SIZE 1 READ_ONLY /end CHARACTERISTIC
/begin COMPU_METHOD CM_bench_counter0 "wire to physical" LINEAR "%16.7" "" COEFFS_LINEAR 1 0 /end COMPU_METHOD
/begin CHARACTERISTIC bench_counter0 "Sequential bounded counter snapshot PWM0,1,2,3,0; not electrical verification" VALUE 0x14dc RL_ULONG 0 CM_bench_counter0 0 639 STEP_SIZE 1 READ_ONLY /end CHARACTERISTIC
/begin COMPU_METHOD CM_bench_counter1 "wire to physical" LINEAR "%16.7" "" COEFFS_LINEAR 1 0 /end COMPU_METHOD
/begin CHARACTERISTIC bench_counter1 "Sequential bounded counter snapshot PWM0,1,2,3,0; not electrical verification" VALUE 0x14e0 RL_ULONG 0 CM_bench_counter1 0 639 STEP_SIZE 1 READ_ONLY /end CHARACTERISTIC
/begin COMPU_METHOD CM_bench_counter2 "wire to physical" LINEAR "%16.7" "" COEFFS_LINEAR 1 0 /end COMPU_METHOD
/begin CHARACTERISTIC bench_counter2 "Sequential bounded counter snapshot PWM0,1,2,3,0; not electrical verification" VALUE 0x14e4 RL_ULONG 0 CM_bench_counter2 0 639 STEP_SIZE 1 READ_ONLY /end CHARACTERISTIC
/begin COMPU_METHOD CM_bench_counter3 "wire to physical" LINEAR "%16.7" "" COEFFS_LINEAR 1 0 /end COMPU_METHOD
/begin CHARACTERISTIC bench_counter3 "Sequential bounded counter snapshot PWM0,1,2,3,0; not electrical verification" VALUE 0x14e8 RL_ULONG 0 CM_bench_counter3 0 639 STEP_SIZE 1 READ_ONLY /end CHARACTERISTIC
/begin COMPU_METHOD CM_bench_counter4 "wire to physical" LINEAR "%16.7" "" COEFFS_LINEAR 1 0 /end COMPU_METHOD
/begin CHARACTERISTIC bench_counter4 "Sequential bounded counter snapshot PWM0,1,2,3,0; not electrical verification" VALUE 0x14ec RL_ULONG 0 CM_bench_counter4 0 639 STEP_SIZE 1 READ_ONLY /end CHARACTERISTIC
/begin COMPU_METHOD CM_bench_trigger_flags "wire to physical" LINEAR "%16.7" "" COEFFS_LINEAR 1 0 /end COMPU_METHOD
/begin CHARACTERISTIC bench_trigger_flags "Latest SOCA observed flags" VALUE 0x14f0 RL_ULONG 0 CM_bench_trigger_flags 0 15 STEP_SIZE 1 READ_ONLY /end CHARACTERISTIC
/begin COMPU_METHOD CM_bench_m1_min "wire to physical" LINEAR "%16.7" "" COEFFS_LINEAR 1 0 /end COMPU_METHOD
/begin CHARACTERISTIC bench_m1_min "M1 raw synchronous min since run start; no smoothing" VALUE 0x14f8 RL_ULONG 0 CM_bench_m1_min 0 4294967295 STEP_SIZE 1 READ_ONLY /end CHARACTERISTIC
/begin COMPU_METHOD CM_bench_m1_max "wire to physical" LINEAR "%16.7" "" COEFFS_LINEAR 1 0 /end COMPU_METHOD
/begin CHARACTERISTIC bench_m1_max "M1 raw synchronous max since run start; no smoothing" VALUE 0x14fc RL_ULONG 0 CM_bench_m1_max 0 4294967295 STEP_SIZE 1 READ_ONLY /end CHARACTERISTIC
/begin COMPU_METHOD CM_bench_m1_count "wire to physical" LINEAR "%16.7" "" COEFFS_LINEAR 1 0 /end COMPU_METHOD
/begin CHARACTERISTIC bench_m1_count "M1 raw synchronous count since run start; no smoothing" VALUE 0x1500 RL_ULONG 0 CM_bench_m1_count 0 4294967295 STEP_SIZE 1 READ_ONLY /end CHARACTERISTIC
/begin COMPU_METHOD CM_bench_m2_min "wire to physical" LINEAR "%16.7" "" COEFFS_LINEAR 1 0 /end COMPU_METHOD
/begin CHARACTERISTIC bench_m2_min "M2 raw synchronous min since run start; no smoothing" VALUE 0x1508 RL_ULONG 0 CM_bench_m2_min 0 4294967295 STEP_SIZE 1 READ_ONLY /end CHARACTERISTIC
/begin COMPU_METHOD CM_bench_m2_max "wire to physical" LINEAR "%16.7" "" COEFFS_LINEAR 1 0 /end COMPU_METHOD
/begin CHARACTERISTIC bench_m2_max "M2 raw synchronous max since run start; no smoothing" VALUE 0x150c RL_ULONG 0 CM_bench_m2_max 0 4294967295 STEP_SIZE 1 READ_ONLY /end CHARACTERISTIC
/begin COMPU_METHOD CM_bench_m2_count "wire to physical" LINEAR "%16.7" "" COEFFS_LINEAR 1 0 /end COMPU_METHOD
/begin CHARACTERISTIC bench_m2_count "M2 raw synchronous count since run start; no smoothing" VALUE 0x1510 RL_ULONG 0 CM_bench_m2_count 0 4294967295 STEP_SIZE 1 READ_ONLY /end CHARACTERISTIC
/begin COMPU_METHOD CM_bench_m3_min "wire to physical" LINEAR "%16.7" "" COEFFS_LINEAR 1 0 /end COMPU_METHOD
/begin CHARACTERISTIC bench_m3_min "M3 raw synchronous min since run start; no smoothing" VALUE 0x1518 RL_ULONG 0 CM_bench_m3_min 0 4294967295 STEP_SIZE 1 READ_ONLY /end CHARACTERISTIC
/begin COMPU_METHOD CM_bench_m3_max "wire to physical" LINEAR "%16.7" "" COEFFS_LINEAR 1 0 /end COMPU_METHOD
/begin CHARACTERISTIC bench_m3_max "M3 raw synchronous max since run start; no smoothing" VALUE 0x151c RL_ULONG 0 CM_bench_m3_max 0 4294967295 STEP_SIZE 1 READ_ONLY /end CHARACTERISTIC
/begin COMPU_METHOD CM_bench_m3_count "wire to physical" LINEAR "%16.7" "" COEFFS_LINEAR 1 0 /end COMPU_METHOD
/begin CHARACTERISTIC bench_m3_count "M3 raw synchronous count since run start; no smoothing" VALUE 0x1520 RL_ULONG 0 CM_bench_m3_count 0 4294967295 STEP_SIZE 1 READ_ONLY /end CHARACTERISTIC
/begin COMPU_METHOD CM_bench_m4_min "wire to physical" LINEAR "%16.7" "" COEFFS_LINEAR 1 0 /end COMPU_METHOD
/begin CHARACTERISTIC bench_m4_min "M4 raw synchronous min since run start; no smoothing" VALUE 0x1528 RL_ULONG 0 CM_bench_m4_min 0 4294967295 STEP_SIZE 1 READ_ONLY /end CHARACTERISTIC
/begin COMPU_METHOD CM_bench_m4_max "wire to physical" LINEAR "%16.7" "" COEFFS_LINEAR 1 0 /end COMPU_METHOD
/begin CHARACTERISTIC bench_m4_max "M4 raw synchronous max since run start; no smoothing" VALUE 0x152c RL_ULONG 0 CM_bench_m4_max 0 4294967295 STEP_SIZE 1 READ_ONLY /end CHARACTERISTIC
/begin COMPU_METHOD CM_bench_m4_count "wire to physical" LINEAR "%16.7" "" COEFFS_LINEAR 1 0 /end COMPU_METHOD
/begin CHARACTERISTIC bench_m4_count "M4 raw synchronous count since run start; no smoothing" VALUE 0x1530 RL_ULONG 0 CM_bench_m4_count 0 4294967295 STEP_SIZE 1 READ_ONLY /end CHARACTERISTIC
/begin COMPU_METHOD CM_drv_enable_state_known "wire to physical" LINEAR "%16.7" "" COEFFS_LINEAR 1 0 /end COMPU_METHOD
/begin CHARACTERISTIC drv_enable_state_known "1 only after both independent driver enable GPIO operations are confirmed; 0 means unknown. Actuation, SPI, SAVE and reboot are fenced until explicit disable succeeds." VALUE 0x1534 RL_UWORD 0 CM_drv_enable_state_known 0 1 STEP_SIZE 1 READ_ONLY /end CHARACTERISTIC
/begin IF_DATA XCP
 /begin PROTOCOL_LAYER 0x0100 5000 5000 5000 5000 5000 5000 5000 8 8 BYTE_ORDER_MSB_LAST ADDRESS_GRANULARITY_BYTE OPTIONAL_CMD SET_REQUEST OPTIONAL_CMD SET_MTA OPTIONAL_CMD UPLOAD OPTIONAL_CMD DOWNLOAD /end PROTOCOL_LAYER
 /begin XCP_ON_CAN 0x0100 CAN_ID_MASTER 0x700 CAN_ID_SLAVE 0x701 BAUDRATE 500000 /end XCP_ON_CAN
/end IF_DATA
/end MODULE
/end PROJECT
