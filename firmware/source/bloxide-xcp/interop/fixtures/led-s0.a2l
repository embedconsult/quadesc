ASAP2_VERSION 1 61
/begin PROJECT BLOXIDE_LED_S0 "Bloxide LED scalar S0"
/begin MODULE LED "LED scalar calibration and measurements"
/begin MOD_COMMON "S0 byte layout" BYTE_ORDER MSB_LAST ALIGNMENT_BYTE 1 ALIGNMENT_WORD 1 ALIGNMENT_LONG 1 ALIGNMENT_FLOAT32_IEEE 1 ALIGNMENT_FLOAT64_IEEE 1 /end MOD_COMMON
/begin RECORD_LAYOUT RL_UWORD FNC_VALUES 1 UWORD COLUMN_DIR DIRECT /end RECORD_LAYOUT
/begin COMPU_METHOD CM_MS "milliseconds" IDENTICAL "%10.0" "ms" /end COMPU_METHOD
/begin COMPU_METHOD CM_PERMILLE "parts per thousand" IDENTICAL "%10.0" "permille" /end COMPU_METHOD
/begin COMPU_METHOD CM_US "microseconds" IDENTICAL "%10.0" "us" /end COMPU_METHOD
/begin COMPU_METHOD CM_COUNT "dimensionless count" IDENTICAL "%10.0" "count" /end COMPU_METHOD
/begin COMPU_METHOD CM_BOOL "logical commanded state" IDENTICAL "%1.0" "boolean" /end COMPU_METHOD
/begin CHARACTERISTIC led.period_ms "LED period" VALUE 0x1000 RL_UWORD 0 CM_MS 100 10000 /end CHARACTERISTIC
/begin CHARACTERISTIC led.duty_permille "LED duty" VALUE 0x1002 RL_UWORD 0 CM_PERMILLE 0 1000 /end CHARACTERISTIC
/begin MEASUREMENT led.uptime_ms "Owner uptime" ULONG CM_MS 1 0 0 4294967295 ECU_ADDRESS 0x2000 /end MEASUREMENT
/begin MEASUREMENT led.sample_sequence "Sample sequence" ULONG CM_COUNT 1 0 0 4294967295 ECU_ADDRESS 0x2004 /end MEASUREMENT
/begin MEASUREMENT led.active_revision "Active revision" ULONG CM_COUNT 1 0 0 4294967295 ECU_ADDRESS 0x2008 /end MEASUREMENT
/begin MEASUREMENT led.phase_us "Phase epoch in owner time" ULONG CM_US 1 0 0 4294967295 ECU_ADDRESS 0x200C /end MEASUREMENT
/begin MEASUREMENT led.applied_period_ms "Acknowledged period" UWORD CM_MS 1 0 100 10000 ECU_ADDRESS 0x2010 /end MEASUREMENT
/begin MEASUREMENT led.applied_duty_permille "Acknowledged duty" UWORD CM_PERMILLE 1 0 0 1000 ECU_ADDRESS 0x2012 /end MEASUREMENT
/begin MEASUREMENT led.commanded_on "Commanded logical output, not physical completion" UBYTE CM_BOOL 1 0 0 1 ECU_ADDRESS 0x2014 /end MEASUREMENT
/begin MEASUREMENT led.rejected_write_count "Rejected owner writes" ULONG CM_COUNT 1 0 0 4294967295 ECU_ADDRESS 0x2018 /end MEASUREMENT
/begin MEASUREMENT daq.dropped_sample_count "Dropped complete samples" ULONG CM_COUNT 1 0 0 4294967295 ECU_ADDRESS 0x201C /end MEASUREMENT
/begin MEASUREMENT led.edge_lateness_us "Last edge lateness" ULONG CM_US 1 0 0 4294967295 ECU_ADDRESS 0x2020 /end MEASUREMENT
/begin MEASUREMENT led.max_edge_lateness_us "Maximum edge lateness" ULONG CM_US 1 0 0 4294967295 ECU_ADDRESS 0x2024 /end MEASUREMENT
/end MODULE
/end PROJECT
