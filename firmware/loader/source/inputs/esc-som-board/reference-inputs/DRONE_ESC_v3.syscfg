/**
 *
 * @cliArgs --device "AM13E230x" --part "AM13E230x" --package "LQFP100_G"
 * @versions {"tool":"1.28.0+4712"}
 */

/**
 * These are the peripherals and settings in this configuration
 */
const ADC1                           = scripting.addPeripheral("ADC");
ADC1["1"].$used                      = false;
ADC1["2"].$used                      = false;
ADC1["3"].$used                      = false;
ADC1["4"].$assignAllowConflicts      = "PA3";
ADC1["4"].$used                      = true;
ADC1["5"].$used                      = false;
ADC1["6"].$used                      = false;
ADC1["7"].$used                      = false;
ADC1["8"].$used                      = false;
ADC1["9"].$assign                    = "PB3";
ADC1["9"].$used                      = true;
ADC1["10"].$used                     = false;
ADC1["11"].$assign                   = "PA28";
ADC1["11"].$used                     = true;
ADC1["12"].$assign                   = "PA17";
ADC1["12"].$used                     = true;
ADC1["13"].$used                     = false;
ADC1["14"].$used                     = false;
ADC1["15"].$assignAllowConflicts     = "PA16";
ADC1["15"].$used                     = true;
ADC1["16"].$used                     = false;
ADC1["17"].$used                     = false;
ADC1["18"].$assign                   = "PC14";
ADC1["18"].$used                     = true;
ADC1["19"].$assign                   = "PC15";
ADC1["19"].$used                     = true;
ADC1["21"].$assign                   = "PB24";
ADC1["21"].$used                     = true;
ADC1["22"].$used                     = false;
ADC1["23"].$used                     = false;
ADC1["24"].$used                     = false;
ADC1["25"].$used                     = false;
ADC1["26"].$used                     = false;
ADC1["27"].$assign                   = "PB27";
ADC1["27"].$used                     = true;
ADC1["28"].$used                     = false;
ADC1["29"].$used                     = false;
ADC1["30"].$used                     = false;
ADC1.$name                           = "ADC0";
ADC1.$assign                         = "A0";
scripting.suppress("Resource conflict,@@@.+?@@@ is also in use by @@@.+?@@@", ADC1, "4");
scripting.suppress("Resource conflict,@@@.+?@@@ is also in use by @@@.+?@@@", ADC1, "15");
const ADC2                           = scripting.addPeripheral("ADC");
ADC2["1"].$used                      = false;
ADC2["2"].$used                      = false;
ADC2["3"].$used                      = false;
ADC2["4"].$used                      = false;
ADC2["5"].$assign                    = "PB4";
ADC2["5"].$used                      = true;
ADC2["6"].$used                      = false;
ADC2["7"].$assign                    = "PB1";
ADC2["7"].$used                      = true;
ADC2["8"].$used                      = false;
ADC2["9"].$used                      = false;
ADC2["10"].$used                     = false;
ADC2["11"].$used                     = false;
ADC2["12"].$assign                   = "PA18";
ADC2["12"].$used                     = true;
ADC2["13"].$assign                   = "PA5";
ADC2["13"].$used                     = true;
ADC2["14"].$used                     = false;
ADC2["15"].$used                     = false;
ADC2["16"].$assign                   = "PC10";
ADC2["16"].$used                     = true;
ADC2["17"].$used                     = false;
ADC2["18"].$assign                   = "PA8";
ADC2["18"].$used                     = true;
ADC2["19"].$assign                   = "PA9";
ADC2["19"].$used                     = true;
ADC2["21"].$used                     = false;
ADC2["22"].$assign                   = "PB25";
ADC2["22"].$used                     = true;
ADC2["23"].$assign                   = "PC8";
ADC2["23"].$used                     = true;
ADC2["24"].$assign                   = "PC11";
ADC2["24"].$used                     = true;
ADC2["25"].$assign                   = "PC12";
ADC2["25"].$used                     = true;
ADC2["26"].$used                     = false;
ADC2["27"].$used                     = false;
ADC2["28"].$assignAllowConflicts     = "PB28";
ADC2["28"].$used                     = false;
ADC2["29"].$used                     = false;
ADC2["30"].$assignAllowConflicts     = "PB30";
ADC2["30"].$used                     = true;
ADC2.$name                           = "ADC1";
ADC2.$assign                         = "A1";
scripting.suppress("Resource conflict,@@@.+?@@@ is also in use by @@@.+?@@@", ADC2, "30");
const ADC3                           = scripting.addPeripheral("ADC");
ADC3["1"].$used                      = false;
ADC3["2"].$assign                    = "PC9";
ADC3["2"].$used                      = true;
ADC3["3"].$assign                    = "PC13";
ADC3["3"].$used                      = false;
ADC3["4"].$assign                    = "PC7";
ADC3["4"].$used                      = true;
ADC3["5"].$assignAllowConflicts      = "PA29";
ADC3["5"].$used                      = true;
ADC3["6"].$used                      = false;
ADC3["7"].$assign                    = "PB26";
ADC3["7"].$used                      = true;
ADC3["8"].$used                      = false;
ADC3["9"].$used                      = false;
ADC3["10"].$assign                   = "PB29";
ADC3["10"].$used                     = true;
ADC3["11"].$used                     = false;
ADC3["12"].$used                     = false;
ADC3["13"].$used                     = false;
ADC3["14"].$used                     = false;
ADC3["15"].$used                     = false;
ADC3["16"].$used                     = false;
ADC3["17"].$used                     = false;
ADC3["18"].$used                     = false;
ADC3["19"].$used                     = false;
ADC3["21"].$used                     = false;
ADC3["22"].$assign                   = "PA7";
ADC3["22"].$used                     = true;
ADC3["23"].$used                     = false;
ADC3["24"].$assign                   = "PB5";
ADC3["24"].$used                     = true;
ADC3["25"].$assign                   = "PA2";
ADC3["25"].$used                     = true;
ADC3["26"].$used                     = false;
ADC3["27"].$used                     = false;
ADC3["28"].$used                     = false;
ADC3["29"].$assign                   = "PB31";
ADC3["29"].$used                     = true;
ADC3["30"].$used                     = false;
ADC3.$name                           = "ADC2";
ADC3.$assign                         = "A2";
scripting.suppress("Resource conflict,@@@.+?@@@ is also in use by @@@.+?@@@", ADC3, "5");
const CMPSS1                         = scripting.addPeripheral("CMPSS");
CMPSS1.$name                         = "CMPSS0_M1";
CMPSS1.$assign                       = "CMP0";
CMPSS1.DACL.$used                    = false;
CMPSS1.HN0.$used                     = false;
CMPSS1.HN1.$used                     = false;
CMPSS1.LN0.$used                     = false;
CMPSS1.LN1.$used                     = false;
CMPSS1.HP0_LP0.$used                 = false;
CMPSS1.HP1_LP1.$used                 = false;
CMPSS1.HP2_LP2.$assignAllowConflicts = "PA29";
CMPSS1.HP2_LP2.$used                 = true;
CMPSS1.HP3_LP3.$used                 = false;
CMPSS1.HN0_LN0.$used                 = false;
CMPSS1.HN1_LN1.$used                 = false;
scripting.suppress("Resource conflict,@@@.+?@@@ is also in use by @@@.+?@@@", CMPSS1, "HP2_LP2");
const CMPSS2                         = scripting.addPeripheral("CMPSS");
CMPSS2.$name                         = "CMPSS3_M2";
CMPSS2.$assign                       = "CMP3";
CMPSS2.DACL.$used                    = false;
CMPSS2.HN0.$used                     = false;
CMPSS2.HN1.$used                     = false;
CMPSS2.LN0.$used                     = false;
CMPSS2.LN1.$used                     = false;
CMPSS2.HP0_LP0.$used                 = false;
CMPSS2.HP1_LP1.$assignAllowConflicts = "PA16";
CMPSS2.HP1_LP1.$used                 = true;
CMPSS2.HP2_LP2.$used                 = false;
CMPSS2.HP3_LP3.$used                 = false;
CMPSS2.HN0_LN0.$used                 = false;
CMPSS2.HN1_LN1.$used                 = false;
scripting.suppress("Resource conflict,@@@.+?@@@ is also in use by @@@.+?@@@", CMPSS2, "HP1_LP1");
const CMPSS3                         = scripting.addPeripheral("CMPSS");
CMPSS3.$name                         = "CMPSS2_M3";
CMPSS3.$assign                       = "CMP2";
CMPSS3.DACL.$used                    = false;
CMPSS3.HN0.$used                     = false;
CMPSS3.HN1.$used                     = false;
CMPSS3.LN0.$used                     = false;
CMPSS3.LN1.$used                     = false;
CMPSS3.HP0_LP0.$used                 = false;
CMPSS3.HP1_LP1.$used                 = false;
CMPSS3.HP2_LP2.$assignAllowConflicts = "PB30";
CMPSS3.HP2_LP2.$used                 = true;
CMPSS3.HP3_LP3.$used                 = false;
CMPSS3.HN0_LN0.$used                 = false;
CMPSS3.HN1_LN1.$used                 = false;
scripting.suppress("Resource conflict,@@@.+?@@@ is also in use by @@@.+?@@@", CMPSS3, "HP2_LP2");
const CMPSS4                         = scripting.addPeripheral("CMPSS");
CMPSS4.$name                         = "CMPSS1_M4";
CMPSS4.$assign                       = "CMP1";
CMPSS4.DACL.$used                    = false;
CMPSS4.HN0.$used                     = false;
CMPSS4.HN1.$used                     = false;
CMPSS4.LN0.$used                     = false;
CMPSS4.LN1.$used                     = false;
CMPSS4.HP0_LP0.$assignAllowConflicts = "PA3";
CMPSS4.HP0_LP0.$used                 = true;
CMPSS4.HP1_LP1.$used                 = false;
CMPSS4.HP2_LP2.$used                 = false;
CMPSS4.HP3_LP3.$used                 = false;
CMPSS4.HN0_LN0.$used                 = false;
CMPSS4.HN1_LN1.$used                 = false;
scripting.suppress("Resource conflict,@@@.+?@@@ is also in use by @@@.+?@@@", CMPSS4, "HP0_LP0");
const DEBUG1                         = scripting.addPeripheral("DEBUG");
DEBUG1.$name                         = "MyDEBUG1";
DEBUG1.$assign                       = "DEBUG";
DEBUG1.DEBUG_TMS_SWDIO.$assign       = "PA13";
DEBUG1.DEBUG_JTCK_SWCLK.$assign      = "PA14";
DEBUG1.DEBUG_JTDI.$assign            = "PA15";
DEBUG1.DEBUG_JTDO_SWO.$assign        = "PA19";
const GPIO1                          = scripting.addPeripheral("GPIO");
GPIO1["0"].$assign                   = "PA6";
GPIO1.$name                          = "BSL_INVOKE";
const GPIO2                          = scripting.addPeripheral("GPIO");
GPIO2["0"].pu_pd                     = "pu";
GPIO2["0"].rx                        = false;
GPIO2["0"].$assignAllowConflicts     = "PB28";
GPIO2.$name                          = "M3_DSHOT_RX_ecap0";
scripting.suppress("Resource conflict,@@@.+?@@@ is also in use by @@@.+?@@@, @@@.+?@@@", GPIO2, "0");
const GPIO3                          = scripting.addPeripheral("GPIO");
GPIO3["0"].$assignAllowConflicts     = "PA26";
GPIO3.$name                          = "M4_DSHOT_RX_ecap1";
scripting.suppress("Resource conflict,@@@.+?@@@ is also in use by @@@.+?@@@, @@@.+?@@@", GPIO3, "0");
const GPIO4                          = scripting.addPeripheral("GPIO");
GPIO4["0"].pu_pd                     = "pu";
GPIO4["0"].rx                        = false;
GPIO4["0"].$assign                   = "PC13";
GPIO4.$name                          = "M1_DRV_CS";
const GPIO5                          = scripting.addPeripheral("GPIO");
GPIO5["0"].$assign                   = "PA30";
GPIO5.$name                          = "M1_nFAULT";
const GPIO6                          = scripting.addPeripheral("GPIO");
GPIO6["0"].pu_pd                     = "pu";
GPIO6["0"].rx                        = false;
GPIO6["0"].$assign                   = "PB14";
GPIO6.$name                          = "M2_DRV_CS";
const GPIO7                          = scripting.addPeripheral("GPIO");
GPIO7["0"].$assign                   = "PB15";
GPIO7.$name                          = "M2_nFAULT";
const GPIO8                          = scripting.addPeripheral("GPIO");
GPIO8["0"].pu_pd                     = "pu";
GPIO8["0"].rx                        = false;
GPIO8["0"].$assign                   = "PB16";
GPIO8.$name                          = "M3_DRV_CS";
const GPIO9                          = scripting.addPeripheral("GPIO");
GPIO9["0"].$assign                   = "PB17";
GPIO9.$name                          = "M3_nFAULT";
const GPIO10                         = scripting.addPeripheral("GPIO");
GPIO10["0"].pu_pd                    = "pu";
GPIO10["0"].rx                       = false;
GPIO10["0"].$assign                  = "PC5";
GPIO10.$name                         = "M4_DRV_CS";
const GPIO11                         = scripting.addPeripheral("GPIO");
GPIO11["0"].$assign                  = "PB0";
GPIO11.$name                         = "M4_nFAULT";
const GPIO12                         = scripting.addPeripheral("GPIO");
GPIO12["0"].pu_pd                    = "pd";
GPIO12["0"].rx                       = false;
GPIO12["0"].$assign                  = "PB10";
GPIO12.$name                         = "DRV_ENABLE";
const GPIO13                         = scripting.addPeripheral("GPIO");
GPIO13["0"].pu_pd                    = "pd";
GPIO13["0"].rx                       = false;
GPIO13["0"].$assign                  = "PB11";
GPIO13.$name                         = "INL_ENABLE";
const GPIO14                         = scripting.addPeripheral("GPIO");
GPIO14["0"].pu_pd                    = "pu";
GPIO14["0"].rx                       = false;
GPIO14["0"].$assign                  = "PB18";
GPIO14.$name                         = "STATUS_LED";
const GPIO15                         = scripting.addPeripheral("GPIO");
GPIO15["0"].$assign                  = "PB2";
GPIO15.$name                         = "MIKRO_INT";
const GPIO16                         = scripting.addPeripheral("GPIO");
GPIO16["0"].rx                       = false;
GPIO16["0"].$assign                  = "PA20";
GPIO16.$name                         = "MIKRO_RST";
const GPIO17                         = scripting.addPeripheral("GPIO");
GPIO17["0"].pu_pd                    = "pu";
GPIO17["0"].rx                       = false;
GPIO17["0"].$assign                  = "PA21";
GPIO17.$name                         = "MIKRO_CS";
const GPIO18                         = scripting.addPeripheral("GPIO");
GPIO18["0"].$assign                  = "PB9";
GPIO18.$name                         = "CAN_TERM";
const MCAN1                          = scripting.addPeripheral("MCAN");
MCAN1.$name                          = "MyMCAN1";
MCAN1.$assign                        = "MCAN0";
MCAN1.RX.$assign                     = "PA11";
MCAN1.TX.$assign                     = "PA12";
const MCPWM1                         = scripting.addPeripheral("MCPWM");
MCPWM1.$name                         = "Motor2";
MCPWM1.$assign                       = "MCPWM3";
MCPWM1["1A"].rx                      = false;
MCPWM1["1A"].$assign                 = "PC25";
MCPWM1["1B"].rx                      = false;
MCPWM1["1B"].$used                   = false;
MCPWM1["2A"].rx                      = false;
MCPWM1["2A"].$assign                 = "PC26";
MCPWM1["2B"].rx                      = false;
MCPWM1["2B"].$used                   = false;
MCPWM1["3A"].rx                      = false;
MCPWM1["3A"].$assign                 = "PC18";
MCPWM1["3B"].rx                      = false;
MCPWM1["3B"].$used                   = false;
const MCPWM2                         = scripting.addPeripheral("MCPWM");
MCPWM2.$name                         = "Motor3";
MCPWM2.$assign                       = "MCPWM0";
MCPWM2["1A"].rx                      = false;
MCPWM2["1A"].$assign                 = "PB0";
MCPWM2["1A"].$used                   = false;
MCPWM2["1B"].rx                      = false;
MCPWM2["1B"].$assign                 = "PB13";
MCPWM2["2A"].rx                      = false;
MCPWM2["2A"].$assign                 = "PB1";
MCPWM2["2A"].$used                   = false;
MCPWM2["2B"].rx                      = false;
MCPWM2["2B"].$used                   = false;
MCPWM2["3A"].rx                      = false;
MCPWM2["3A"].$assign                 = "PA10";
MCPWM2["3B"].rx                      = false;
MCPWM2["3B"].$assign                 = "PA25";
const MCPWM3                         = scripting.addPeripheral("MCPWM");
MCPWM3.$name                         = "Motor1";
MCPWM3.$assign                       = "MCPWM1";
MCPWM3["1A"].$assign                 = "PB6";
MCPWM3["1B"].$used                   = false;
MCPWM3["2A"].$assign                 = "PB7";
MCPWM3["2B"].$used                   = false;
MCPWM3["3A"].$assign                 = "PB8";
MCPWM3["3B"].$assign                 = "PB12";
const MCPWM4                         = scripting.addPeripheral("MCPWM");
MCPWM4.$name                         = "Motor4";
MCPWM4.$assign                       = "MCPWM2";
MCPWM4["1A"].$assign                 = "PC1";
MCPWM4["1B"].$used                   = false;
MCPWM4["2A"].$assign                 = "PC3";
MCPWM4["2B"].$used                   = false;
MCPWM4["3A"].$assign                 = "PA24";
MCPWM4["3B"].$used                   = false;
const MCPWM5                         = scripting.addPeripheral("MCPWM");
MCPWM5.$name                         = "DSHOT_TX/BUZZER";
MCPWM5.$assign                       = "MCPWM4";
MCPWM5["1A"].$assign                 = "PB19";
MCPWM5["1B"].$used                   = false;
MCPWM5["2A"].$assignAllowConflicts   = "PB28";
MCPWM5["2B"].$assignAllowConflicts   = "PA27";
MCPWM5["3A"].$assignAllowConflicts   = "PA26";
MCPWM5["3B"].$assignAllowConflicts   = "PA4";
scripting.suppress("Resource conflict,@@@.+?@@@ is also in use by @@@.+?@@@, @@@.+?@@@", MCPWM5, "2A");
scripting.suppress("Resource conflict,@@@.+?@@@ is also in use by @@@.+?@@@", MCPWM5, "2B");
scripting.suppress("Resource conflict,@@@.+?@@@ is also in use by @@@.+?@@@, @@@.+?@@@", MCPWM5, "3A");
scripting.suppress("Resource conflict,@@@.+?@@@ is also in use by @@@.+?@@@", MCPWM5, "3B");
const SYSCTL1                        = scripting.addPeripheral("SYSCTL");
SYSCTL1.$name                        = "MySYSCTL1";
SYSCTL1.$assign                      = "SYSCTL";
SYSCTL1.SYSCTL_FCC_IN.$used          = false;
SYSCTL1.SYSCTL_XCLKOUT.$used         = false;
SYSCTL1.SYSCTL_HFCLKIN.$used         = false;
SYSCTL1.SYSCTL_X1.$assign            = "PC16_X1";
SYSCTL1.SYSCTL_X2.$assign            = "PC17_X2";
SYSCTL1.SYSCTL_NRST.$assign          = "NRST";
const TIMER1                         = scripting.addPeripheral("TIMER");
TIMER1.$name                         = "M3_M1_DSHOT_RX";
TIMER1.CCP0.$assignAllowConflicts    = "PB28";
TIMER1.CCP0.$used                    = true;
TIMER1.CCP1.$assignAllowConflicts    = "PA27";
TIMER1.CCP1.$used                    = true;
scripting.suppress("Resource conflict,@@@.+?@@@ is also in use by @@@.+?@@@, @@@.+?@@@", TIMER1, "CCP0");
scripting.suppress("Resource conflict,@@@.+?@@@ is also in use by @@@.+?@@@", TIMER1, "CCP1");
const TIMER2                         = scripting.addPeripheral("TIMER");
TIMER2.$name                         = "M4_M2_DSHOT_RX";
TIMER2.CCP0.$assignAllowConflicts    = "PA26";
TIMER2.CCP0.$used                    = true;
TIMER2.CCP1.$assignAllowConflicts    = "PA4";
TIMER2.CCP1.$used                    = true;
scripting.suppress("Resource conflict,@@@.+?@@@ is also in use by @@@.+?@@@, @@@.+?@@@", TIMER2, "CCP0");
scripting.suppress("Resource conflict,@@@.+?@@@ is also in use by @@@.+?@@@", TIMER2, "CCP1");
const UCx1                           = scripting.addPeripheral("UCx");
UCx1.$name                           = "BSL_UART";
UCx1.$assign                         = "UC4";
UCx1.RTS_POCI.$used                  = false;
UCx1.RX_SCL.$used                    = false;
UCx1.TX_SDA.$used                    = false;
UCx1.RTS.$used                       = false;
UCx1.CTS.$used                       = false;
UCx1.TX_SDA_PICO.$used               = true;
UCx1.CTS_CS0.$used                   = false;
UCx1.RX_SCL_SCLK.$assign             = "PA1";
UCx1.RX_SCL_SCLK.$used               = true;
const UCx2                           = scripting.addPeripheral("UCx");
UCx2.$name                           = "UART1";
UCx2.$assign                         = "UC1";
UCx2.RTS_POCI.$used                  = false;
UCx2.RX_SCL.$used                    = false;
UCx2.TX_SDA.$used                    = false;
UCx2.RTS.$used                       = false;
UCx2.CTS.$used                       = false;
UCx2.TX_SDA_PICO.$assign             = "PB21";
UCx2.TX_SDA_PICO.$used               = true;
UCx2.CTS_CS0.$used                   = false;
UCx2.RX_SCL_SCLK.$assign             = "PB22";
UCx2.RX_SCL_SCLK.$used               = true;
const UCx3                           = scripting.addPeripheral("UCx");
UCx3.$name                           = "I2C";
UCx3.$assign                         = "UC2";
UCx3.RTS_POCI.$used                  = false;
UCx3.RX_SCL.$assign                  = "PA23";
UCx3.RX_SCL.$used                    = true;
UCx3.TX_SDA.$assign                  = "PA22";
UCx3.TX_SDA.$used                    = true;
UCx3.RTS.$used                       = false;
UCx3.CTS.$used                       = false;
UCx3.TX_SDA_PICO.$used               = false;
UCx3.CTS_CS0.$used                   = false;
UCx3.RX_SCL_SCLK.$used               = false;
const UCx4                           = scripting.addPeripheral("UCx");
UCx4.$useCase                        = "SPI - 3WIRE";
UCx4.$name                           = "SPI";
UCx4.$assign                         = "UC3";
UCx4.TX_SDA_PICO.$assign             = "PC6";
UCx4.RTS_POCI.$assign                = "PC4";
UCx4.RX_SCL_SCLK.$assign             = "PC2";

/**
 * Pinmux solution for unlocked pins/peripherals. This ensures that minor changes to the automatic solver in a future
 * version of the tool will not impact the pinmux you originally saw.  These lines can be completely deleted in order to
 * re-solve from scratch.
 */
TIMER1.$suggestSolution           = "TIMG4_0";
TIMER2.$suggestSolution           = "TIMG12_0";
UCx1.TX_SDA_PICO.$suggestSolution = "PA0";
